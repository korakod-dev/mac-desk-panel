// ---------------------------------------------------------------------------
//  T-Display-S3 — landscape dashboard
//
//  Four pages, cycled with IO14, rendered on the 320x170 panel in landscape
//  with smooth fonts generated by tools/make_vlw.py:
//
//    1. flip   a split-flap clock, over the temperature and what it feels like
//    2. usage  Claude Code 5h / 7d limits, from tools/usage_server.py
//    3. mac    the machine at the end of the cable: charge, memory, disk, and
//              a column per core
//    4. pomo   a pomodoro timer, which is the one page here holding a state of
//              its own rather than a reading of something else
//
//  The board's own vitals are held behind a hold on IO14 instead of taking a
//  place in that cycle. BOOT refreshes the page in front of you, and dims or
//  brightens the panel when held.
//
//  All four are coloured out of one ramp, the flip clock's own: teal, blue,
//  violet, magenta, running across whatever a page is made of. It answers "which
//  reading is this" and nothing else — green, orange and red are kept for how a
//  reading is doing, so a page can say both at once. See "the ramp" and "cards".
//
//  Over any of them, a banner the Mac can raise: POST a line to /notify on
//  tools/mac_stats_server.py and it goes up here, flashing the backlight, until
//  a button acknowledges it. Meant for the things worth interrupting for — a
//  Claude Code hook waiting on an answer, a build that failed.
//
//  The panel also picks its own page and brightness when left alone. It moves
//  to the Mac page while that machine is loaded and to the usage page as a
//  window fills; any button hands control back for two minutes.
//
//  Where it comes to rest says whether anyone is at the Mac: the usage page
//  while that machine is answering with a screen lit, the flip clock once it
//  stops or goes dark. Dark means nobody is working and the clock is the only
//  thing here still moving; lit means somebody sat down, and what is left of the
//  window is what they need first.
//
//  Brightness says the same thing on the channel you take in without looking.
//  75% while somebody is there, 25% once they are not. Never blanked — this is
//  a panel on a desk, not a second screen for the Mac, and the hours that
//  machine is away are exactly the hours nothing else here is showing the time.
//  See "automatic behaviour".
//
//  Every page is composed into a full-screen sprite in PSRAM and pushed in one
//  go, so nothing flickers and partial redraws can't leave stale pixels behind.
//
//  The network comes from whichever link is answering: tools/usb_net_bridge.py
//  on the far end of the USB-C cable if it is running, otherwise WiFi. See
//  net_link.h — nothing on this side has to care which one it got.
//
//  Serial commands (115200, or any baud — the S3's USB CDC ignores it):
//    N   advance to the next page
//    S   dump the framebuffer, for tools/grab_screen.py
//    A   toggle automatic page selection
//    V   toggle the vitals overlay
//    P   start or pause the pomodoro timer
//    R   clear the pomodoro set, back to a first block not yet started
// ---------------------------------------------------------------------------

#include <Arduino.h>
#include <TFT_eSPI.h>
#include <WiFi.h>
#include <ArduinoJson.h>
#include <esp_system.h>
#include <esp_task_wdt.h>
#include <time.h>

#include "layout.h"
#include "net_link.h"
#include "secrets.h"
#include "../fonts/ui16.h"
#include "../fonts/ui24.h"
#include "../fonts/big64.h"
#include "../fonts/flip88.h"

// --- board ------------------------------------------------------------------

#define PIN_POWER_ON 15   // gates the LCD rail — must be high before tft.init()
#define PIN_BTN_NEXT 14
#define PIN_BTN_ACT  0    // BOOT
#define PIN_BAT_ADC  4    // battery through a 1:2 divider

static const int16_t SCR_W = 320;   // landscape
static const int16_t SCR_H = 170;

// --- watchdog -----------------------------------------------------------------
//
// A panel meant to be read for weeks has to be able to come back from being
// wedged, because the failure mode otherwise is noticing days later that the
// clock stopped. The loop task is watched: the Arduino core feeds it once per
// pass through loop(), and serviceWhileBlocked() feeds it during a fetch that
// has not returned yet.
//
// Thirty seconds against a longest legitimate stall of about eight. Requests
// over the USB link are fed every couple of milliseconds by the idle hook, so
// they are not the constraint; a weather fetch over WiFi is. That one blocks
// inside HTTPClient, which offers no callback to feed from, for as long as its
// own timeout allows plus whatever DNS and the TLS handshake take.
//
// Eight is one request, and a pass can carry five. The four host services and
// the forecast come due on timers of their own and coincide by arithmetic —
// and a link that has just come up clears three of them at once on purpose, so
// the pass right after the USB bridge lets go of the port chains them by
// design. On the radio, with the Mac's LAN address answering nothing, that is
// four connect timeouts and a TLS handshake in one pass that never comes back
// to feed anything: a wedged panel by this timer's reckoning and a working one
// by every other. Which is why wifiGet() calls the same idle hook either side
// of each request — the budget is spent per request, where it was measured,
// rather than per pass, where it was not.
//
// The margin is deliberate and the number is not a guess at the average. A
// watchdog that trips on a slow morning is a watchdog that gets switched off,
// and then it is not protecting anything. Recovering a hung panel in half a
// minute rather than fifteen seconds costs nothing worth having.
static const uint32_t WDT_TIMEOUT_S = 30;

// The watchdog catches a loop that stopped turning. This catches the other kind
// of wedge, the one it is blind to by construction: the loop still turning, the
// cable still in, and nothing on the other end of it answering.
//
// HWCDC decides whether a host is there from SOF interrupts and an IN_EMPTY it
// only ever re-arms once, so a suspend and a resume can leave it saying "not
// connected" with the cable in and the bridge running — and a write in that
// state is dropped rather than sent, so the panel stops asking and the bridge,
// which only speaks when spoken to, never says anything again. Nothing in the
// firmware can re-enumerate a USB device. A restart can.
//
// Five minutes, and only against the signature of that particular failure:
// silence from a bridge that *was* answering, the bus still ticking (so the Mac
// is awake — asleep, the SOF stops and the silence is expected), and the CDC
// insisting it is not connected (which a merely stopped bridge does not cause).
// It fires at most once per episode, because after the restart nothing has
// answered yet and usbSilentFor() says 0 until something does.
static const uint32_t USB_DEAD_MS = 300000;

static esp_reset_reason_t bootReason = ESP_RST_UNKNOWN;

// A restart the panel asked for, told apart from a reflash: both arrive as
// ESP_RST_SW and only one of them is worth putting on the screen. RTC memory
// survives a software reset and not a power cycle, which is exactly the life of
// the question — a panel someone has just plugged in has nothing to explain.
RTC_NOINIT_ATTR uint32_t restartTag;
static const uint32_t TAG_LINK_DEAD = 0x4C4B4444;  // 'LKDD'

// What the banner and the vitals row both read, decided once at boot so the two
// cannot disagree about why the panel is up.
static const char *bootLabel   = "unknown";
static bool        bootUnasked = false;

static const char *resetName(esp_reset_reason_t r) {
  switch (r) {
    case ESP_RST_POWERON:   return "power";
    case ESP_RST_EXT:       return "reset";
    case ESP_RST_SW:        return "reflash";
    case ESP_RST_PANIC:     return "crash";
    case ESP_RST_INT_WDT:   return "int wdt";
    case ESP_RST_TASK_WDT:  return "wdt";
    case ESP_RST_WDT:       return "wdt";
    case ESP_RST_BROWNOUT:  return "brownout";
    case ESP_RST_DEEPSLEEP: return "sleep";
    default:                return "unknown";
  }
}

// Restarts the panel did not choose. Worth putting on the screen, because a
// watchdog that quietly recovers the panel at four in the morning is one you
// never learn anything from — the only other trace is an uptime that went back
// to zero while nobody was looking.
static bool bootWasAbnormal(esp_reset_reason_t r) {
  return r == ESP_RST_PANIC || r == ESP_RST_INT_WDT || r == ESP_RST_TASK_WDT ||
         r == ESP_RST_WDT   || r == ESP_RST_BROWNOUT;
}

static const int16_t BAR_TOP    = 20;          // status bar height
static const int16_t BAR_BOTTOM = 18;          // hint bar height
static const int16_t BODY_TOP   = BAR_TOP;
static const int16_t BODY_BOT   = SCR_H - BAR_BOTTOM;

// --- theme ------------------------------------------------------------------

static const uint16_t C_BG     = 0x0861;  // near-black
static const uint16_t C_BAR    = 0x18E3;
static const uint16_t C_TEXT   = 0xFFFF;
static const uint16_t C_DIM    = 0x8C71;
static const uint16_t C_ACCENT = 0x05FF;  // cyan
static const uint16_t C_WARM   = 0xFD20;  // orange
static const uint16_t C_OK     = 0x2FEB;  // green
static const uint16_t C_ERR    = 0xF9C7;  // red

// --- the ramp ---------------------------------------------------------------
//
// Teal, blue, violet, magenta. It began as the four cards of the flip clock and
// is now what the whole panel is coloured with, because the thing it encodes
// there is the thing every other page needed too: position, not severity.
//
// A 4 is not worse than a 3. The 7d window is not worse than the 5h one, disk is
// not worse than memory, and a P core at 90% is not a warning — it is a P core
// doing its job. Every other colour here already answers "how bad is this", and
// answering "which one is this" with the same four was how a page ended up
// either monochrome or lying. These four are clear of the green/orange/red that
// means severity, so the two questions can be asked at once: the card says which
// reading you are looking at, the figure on it says how that reading is doing.
//
// Used the same way everywhere. It runs left to right, or top to bottom, across
// whatever a page is made of, so a card is the same colour every time you land
// on it — and the page dots in the status bar are the same four in the same
// order, which is what makes the dot and the page it stands for match.
static const uint16_t C_TEAL    = 0x0656;
static const uint16_t C_BLUE    = 0x2BDF;
static const uint16_t C_VIOLET  = 0x8A7F;
static const uint16_t C_MAGENTA = 0xF9F4;

// The four cards of the flip clock, left to right, and the four page dots.
static const uint16_t C_FLIP[4] = {C_TEAL, C_BLUE, C_VIOLET, C_MAGENTA};

// The two core clusters on the Mac page: the two ends of the ramp, which is as
// far apart as two hues on this panel get. That distance is the whole job —
// the blocks have to separate at arm's length, which is where the page is
// actually read from.
static const uint16_t C_ECORE  = C_TEAL;     // efficiency
static const uint16_t C_PCORE  = C_MAGENTA;  // performance

// A darker cast of a colour, scaled in RGB565's own channel widths. Everything
// built out of the ramp is built out of this: the fold on a flip card, the body
// of a data card, the well a bar sits in. One function so that "the same hue,
// quieter" means the same thing on every page.
static uint16_t shade(uint16_t c, uint8_t pct) {
  uint32_t r = (c >> 11) & 0x1F, g = (c >> 5) & 0x3F, b = c & 0x1F;
  return (uint16_t)(((r * pct / 100) << 11) | ((g * pct / 100) << 5) |
                    (b * pct / 100));
}

TFT_eSPI tft = TFT_eSPI();
TFT_eSprite fb = TFT_eSprite(&tft);

// --- font switching ---------------------------------------------------------
// TFT_eSPI routes drawString through the smooth font whenever one is loaded, so
// the built-in bitmap fonts are only reachable with no smooth font active.

static void useFont(const uint8_t *font) {
  fb.unloadFont();
  if (font) fb.loadFont(font);
}

// --- buttons ----------------------------------------------------------------

// Two buttons and more than two things to do with them, since the system page
// stopped being a page and took the backlight toggle with it. A hold is the
// cheapest way to find a third and fourth action on a board with no third
// button.
//
// The pomodoro page wants a fifth, and takes it by going further down the same
// hold rather than by inventing a gesture: a second stop three seconds in,
// where the one action that throws away more than a phase sits. Depth is the
// right axis for it — everything behind a hold on that page is something you
// lose work to, and this loses the most.
enum class Press : uint8_t { None, Short, Long, Held };

class Button {
public:
  explicit Button(uint8_t pin) : _pin(pin) {}

  void begin() { pinMode(_pin, INPUT_PULLUP); }

  // One event per press. A hold fires the moment it passes the threshold, with
  // the button still down — waiting for the release would mean holding a button
  // with no idea whether it had taken. A short press therefore has to fire on
  // the release instead, and only when the hold did not already fire: the two
  // cannot both be decided at the moment the finger lands.
  Press poll() {
    bool level = digitalRead(_pin) == LOW;
    uint32_t now = millis();

    if (level != _raw) { _raw = level; _changed = now; }

    if (now - _changed > DEBOUNCE_MS && level != _stable) {
      _stable = level;
      if (_stable) {
        _down  = now;
        _fired = false;
        _held  = false;
      } else if (!_fired) {
        return Press::Short;
      }
    }

    if (_stable && !_fired && now - _down >= HOLD_MS) {
      _fired = true;
      return Press::Long;
    }

    // The second stop fires on top of the first rather than instead of it: the
    // finger passed that mark on the way down here and the panel has already
    // acted on it. So whatever reads this has to be an action that overrides
    // the shallower one, never one that needs it not to have happened.
    if (_stable && _fired && !_held && now - _down >= HELD_MS) {
      _held = true;
      return Press::Held;
    }
    return Press::None;
  }

  // Where a hold stands while it is still in the finger, for a hint bar that
  // has to name the stop it is about to reach. A hold with two stops in it is
  // only usable if the screen says how far down the next one is; without these
  // the depth would be remembered rather than read.
  bool pastLong() const { return _stable && _fired && !_held; }
  bool pastHeld() const { return _stable && _held; }

private:
  // Long enough not to fire on a firm tap, short enough that the panel answers
  // before you wonder whether it noticed.
  static const uint32_t DEBOUNCE_MS = 25, HOLD_MS = 600;

  // The second stop. Far enough past the first that nobody lands on it by
  // holding a moment too long, close enough that the wait is not read as a
  // hang — and the first stop has already answered on the screen by then, so
  // these are not three seconds of nothing.
  static const uint32_t HELD_MS = 3000;

  uint8_t  _pin;
  bool     _raw = false, _stable = false, _fired = false, _held = false;
  uint32_t _changed = 0, _down = 0;
};

Button btnNext(PIN_BTN_NEXT);
Button btnAct(PIN_BTN_ACT);

// --- weather ----------------------------------------------------------------

// Only what the combined page shows. Humidity, wind, and the daily high and low
// were dropped along with the separate weather page; the sunrise and sunset
// went when the backlight stopped tracking the hour and started tracking the
// Mac. None of them are requested either, so the response stays small.
struct Weather {
  bool     valid    = false;
  float    temp     = 0;
  float    feels    = 0;
  int      code     = -1;
  uint32_t fetched  = 0;
  String   error;
};

Weather weather;

static uint16_t tempColor(float t) {
  if (t >= 35) return C_ERR;
  if (t >= 30) return C_WARM;
  if (t <= 20) return C_ACCENT;
  return C_OK;
}

static bool fetchWeather() {
  if (!net::online()) {
    weather.error = "not connected";
    return false;
  }

  // Current conditions only. The daily block used to come too, for a sunset
  // the backlight no longer has a use for.
  String url = String("https://api.open-meteo.com/v1/forecast?latitude=") +
               String(WEATHER_LAT, 4) + "&longitude=" + String(WEATHER_LON, 4) +
               "&current=temperature_2m,apparent_temperature,weather_code"
               "&timezone=" WEATHER_TZ_URL "&forecast_days=1";

  String payload;
  if (!net::get(url, payload, weather.error)) return false;

  JsonDocument doc;
  DeserializationError err = deserializeJson(doc, payload);

  if (err) {
    weather.error = String("JSON: ") + err.c_str();
    return false;
  }

  JsonObject cur = doc["current"];
  weather.temp  = cur["temperature_2m"]       | 0.0f;
  weather.feels = cur["apparent_temperature"] | 0.0f;
  weather.code  = cur["weather_code"]         | -1;

  weather.valid   = true;
  weather.fetched = millis();
  weather.error   = "";
  Serial.printf("[weather] %.1fC feels %.1fC code=%d\n", weather.temp,
                weather.feels, weather.code);
  return true;
}

// --- the services on the host ------------------------------------------------
//
// Three pages and the notification banner are fed by the two servers on the
// machine at the end of the cable. Where that machine is depends on how the
// request travels: over USB it is the bridge's own host, named by an alias the
// bridge resolves to loopback — the laptop moves between networks and its LAN
// address is not something to depend on. Over WiFi there is no bridge, so it
// has to be the address from secrets.h.
//
// Plain HTTP throughout: these serve a handful of numbers over a cable or the
// same subnet, so TLS would only cost handshake time and a second certificate
// path to keep working.
static String hostUrl(int port, const char *path) {
  String host = net::via() == net::Via::Usb ? String(USAGE_HOST_USB)
                                            : String(USAGE_HOST);
  return "http://" + host + ":" + String(port) + path;
}

// All four answer out of memory on the host, in single-digit milliseconds even
// with the machine loaded enough to be worth looking at. The default timeout is
// sized for a weather fetch the host has to do DNS and TLS for, and spending
// eight seconds of frozen panel to discover the bridge has stopped answering is
// the wrong trade. Two seconds rather than one because the host is sometimes
// the busy machine the core columns exist to show.
static const uint32_t HOST_TIMEOUT = 2000;

// The one request the host cannot answer out of memory: see fetchUsage().
static const uint32_t USAGE_LIVE_TIMEOUT = 2500;

// --- Claude Code usage limits -----------------------------------------------

struct Usage {
  bool     valid   = false;
  int      h5      = -1;      // percent of the 5-hour window used
  time_t   h5reset = 0;       // epoch the window rolls over, 0 if unknown
  int      d7      = -1;      // percent of the 7-day window used
  time_t   d7reset = 0;
  int      age     = -1;      // cache age in seconds, as reported at `fetched`
  bool     live    = false;   // the host asked the API for this one
  uint32_t fetched = 0;
  String   error;
};

Usage usage;

// How stale the reading is *now*. `age` is only true as of the moment it was
// fetched, so the time since then has to be added — otherwise a failed poll
// leaves the age frozen at its last value and a dead link reads as fresh.
static int usageAgeNow() {
  if (!usage.valid || usage.age < 0) return -1;
  return usage.age + (int)((millis() - usage.fetched) / 1000);
}

// The host serves this out of two files that something else writes on its own
// schedule, and the slower of them -- the desktop app's, the one that answers
// whenever no Claude Code session is running -- is refreshed about every
// fifteen minutes. `live` asks it to go and ask the API instead, which is
// the only reading with no lag in it. That costs a request off this machine,
// so it is asked for only while the usage page is the page on screen, and the
// host falls back to the files whenever it cannot be had.
static bool fetchUsage(bool live) {
  if (!net::online()) {
    usage.error = "not connected";
    return false;
  }

  String payload;
  // Longer than the others because this one can wait on the host waiting on
  // the API. The host gives up at 1.5s, so this is that plus the round trip;
  // a slow answer then costs a still panel for a moment rather than a poll
  // thrown away after two seconds of waiting for it.
  if (!net::get(hostUrl(USAGE_PORT, live ? "/usage?live=1" : "/usage"), payload,
                usage.error, live ? USAGE_LIVE_TIMEOUT : HOST_TIMEOUT,
                HOST_TOKEN)) {
    return false;
  }

  JsonDocument doc;
  DeserializationError err = deserializeJson(doc, payload);
  if (err) {
    usage.error = String("JSON: ") + err.c_str();
    return false;
  }

  usage.h5      = doc["h5"]       | -1;
  usage.h5reset = doc["h5_reset"] | 0;
  usage.d7      = doc["d7"]       | -1;
  usage.d7reset = doc["d7_reset"] | 0;
  usage.age     = doc["age"]      | -1;
  usage.live    = doc["live"]     | false;

  usage.valid   = usage.h5 >= 0 || usage.d7 >= 0;
  usage.fetched = millis();
  usage.error   = usage.valid ? "" : "no reading yet";
  Serial.printf("[usage] 5h=%d%% 7d=%d%% age=%ds%s\n", usage.h5, usage.d7,
                usage.age, usage.live ? " live" : "");
  return usage.valid;
}

// --- Mac vitals -------------------------------------------------------------

struct MacStats {
  bool     valid    = false;
  int      batPct   = -1;
  String   batState;           // "discharging" / "charging" / "charged" / ...
  int      batMins  = -1;      // minutes left, -1 while the OS has no estimate
  float    load1    = -1;
  int      ncpu     = -1;
  int      memUsed  = -1;      // percent
  int      diskFree = -1;      // GB — off the page since the merge, still logged
  int      diskUsed = -1;      // percent
  String   display;            // "external" / "builtin" / "asleep" / "none"
  int      idle     = -1;      // seconds since anyone last touched the Mac
  uint32_t up       = 0;       // seconds since the Mac booted
  int      age      = -1;      // snapshot age in seconds, as reported at `fetched`
  uint32_t fetched  = 0;
  String   error;
};

MacStats mac;

// How stale the reading is *now*, the same sum usageAgeNow() makes and for a
// sharper reason: the host samples these in a background thread, so a fetch
// that answered in a millisecond can still be carrying a snapshot from minutes
// ago if that thread has died. Without the server's own age the panel would
// call it fresh, because its fetch was.
static int macAgeNow() {
  if (!mac.valid) return -1;
  return (mac.age >= 0 ? mac.age : 0) + (int)((millis() - mac.fetched) / 1000);
}

// How old a reading may be and still describe the machine as it is now. The
// host resamples every five seconds and the panel asks every ten, so a current
// reading cannot be older than fifteen; thirty allows one poll to go missing
// without the panel calling the Mac dead over it.
static const int MAC_STALE_S = 30;

// Whether readings are still arriving, and so whether the numbers on the Mac
// page describe the machine as it is now. Something over there is being
// scheduled to send them; no probe of the panel's own is needed for this and
// none would be better — a sleeping Mac has a Bonjour sleep proxy answering the
// network on its behalf, while a process has to actually run to fill in a
// battery percentage.
static bool macAnswering() {
  int age = macAgeNow();
  return age >= 0 && age <= MAC_STALE_S;
}

// Whether anything over there is lit. "" is the reading having failed, and is
// read as lit: an unknown screen should leave the panel behaving as it did
// before this field existed, not park it on the clock in front of someone who
// is working.
//
// "none" is documented as rare and transient, and is taken at face value
// anyway. Reaching it means the display list emptied, which off a desk happens
// while a monitor is being plugged or unplugged — a poll or two on the clock,
// self-correcting, and not worth carrying a settling timer to avoid.
static bool macScreensOn() {
  return !(mac.display == "asleep" || mac.display == "none");
}

// The panel's answer to "is anyone over there", which is the question the
// resting page and the backlight are really asking.
//
// This used to be macAnswering() alone, and deliberately said nothing about the
// screen: a Mac in clamshell driving nothing was awake by that test, on the
// grounds that awake meant "ready to use". What that missed is that this Mac is
// hardly ever *not* ready to use. Its screens idle out after ten minutes, but
// LINE and Claude both hold sleep assertions, so the machine itself keeps
// answering all night — and the panel sat on the Claude usage page, at
// three-quarter brightness, on a desk in a dark room, saying somebody was
// working. Even a Mac that really is asleep dark-wakes for maintenance every
// fifteen minutes with Power Nap on, and each of those was another minute and a
// half of the same thing.
//
// Every screen being off is the closest this machine has to "nobody is here",
// and it is the same event a person means by "the Mac went to sleep" — the
// screen going dark is the whole of what they saw. The reading costs nothing:
// mac_stats_server takes it on its fast pass from the framework that owns it.
//
// What that reading still could not see is the screens coming on *without* a
// person. This Mac wakes itself out of deep sleep for a notification, lights
// the screens for anything from one second to half a minute, and goes back to
// sleep — seven of the twenty full wakes in the week this was written, three of
// them in one day, against six the machine was woken for on purpose. Every one
// of those was the panel jumping off the clock onto the usage page at
// three-quarter brightness, on a desk nobody was sitting at, for as long as the
// wake lasted plus the thirty seconds it takes the reading to go stale. It is
// the same complaint the screen reading was added to answer, arriving through
// the other door.
//
// So the question is put to the one thing a wake for a notification cannot
// fake: whether anybody has touched the machine. mac_stats_server turns the HID
// clock into wall-clock seconds since the last keyboard or mouse event — see
// idle() there for why that is more than reporting the counter — and screens
// that have been on that long with nothing touched are on for a reason that is
// not a person.
//
// Ten minutes because that is this Mac's own display-sleep timeout: within it,
// the screens being on is the machine agreeing that somebody is here. Past it
// they are on for something else — a wake nobody asked for, or a video holding
// the display awake, and a film is not work the usage page has anything to say
// about. Either way the panel rests on the clock, and the first touch of the
// mouse brings it back inside a poll.
static const int MAC_IDLE_S = 600;

// An unknown idle reading is read as tended, on the same principle as an
// unknown screen above: an older server, or one whose framework would not load,
// should leave the panel behaving as it did before this field existed.
static bool macTended() { return mac.idle < 0 || mac.idle <= MAC_IDLE_S; }

// Two things read this — the resting page and the backlight — and they must not
// disagree about the same machine, which is why it is one function rather than
// the same test written twice.
static bool macAwake() {
  return macAnswering() && macScreensOn() && macTended();
}

// The word the status bar puts beside the link, and nullptr when there is
// nothing to say. The backlight already answers "is anybody at the Mac"; what
// it cannot answer is *why* it dropped, and the reasons behind it are not the
// same fact. Only one of them is the machine having gone to sleep, and it is
// the only one this will say out loud.
//
// The test is the screens, and it is the last thing the Mac said about them
// rather than a fresh reading — a failed fetch leaves the field alone, so it
// keeps holding what the machine reported before it stopped answering. That is
// what makes the word survive the machine going all the way under: the screens
// go dark first and the Mac says so, and then the whole host goes quiet a while
// later with that reading still standing. A sleeping Mac is a dark one that
// then went away, in that order.
//
// It also refuses the two things that are not sleep, which is the whole point
// of having a word for it:
//
//   untended   awake, screens on, nobody having touched it for ten minutes.
//              The panel dims for this too, and calling it sleep would be an
//              assertion with no reading behind it.
//   silence    the host stopped answering with its screens last known on — a
//              bridge that died, a server that was restarted, the sixty seconds
//              an upload holds the port. The Mac never said it was going
//              anywhere, so neither does this.
//
// Absence carries the rest: dim with no word is the Mac awake and untended, and
// a link name gone red is the panel having lost the machine rather than the
// machine having gone to bed.
static const char *macRestLabel() {
  if (macAwake()) return nullptr;
  return macScreensOn() ? nullptr : "sleep";
}

static bool fetchMac() {
  if (!net::online()) {
    mac.error = "not connected";
    return false;
  }

  String payload;
  if (!net::get(hostUrl(MAC_PORT, "/mac"), payload, mac.error, HOST_TIMEOUT,
                HOST_TOKEN)) {
    return false;
  }

  JsonDocument doc;
  DeserializationError err = deserializeJson(doc, payload);
  if (err) {
    mac.error = String("JSON: ") + err.c_str();
    return false;
  }

  mac.batPct   = doc["bat_pct"]      | -1;
  mac.batState = doc["bat_state"]    | "";
  mac.batMins  = doc["bat_mins"]     | -1;
  mac.load1    = doc["load1"]        | -1.0f;
  mac.ncpu     = doc["ncpu"]         | -1;
  mac.memUsed  = doc["mem_used"]     | -1;
  mac.diskFree = doc["disk_free_gb"] | -1;
  mac.diskUsed = doc["disk_used"]    | -1;
  mac.display  = doc["display"]      | "";
  mac.idle     = doc["idle"]         | -1;
  mac.up       = doc["uptime_s"]     | 0;
  mac.age      = doc["age"]          | -1;

  // The server answers with every field present but unknown ones set to -1, so
  // a reply that carries nothing readable is a failure, not an empty machine.
  mac.valid   = mac.batPct >= 0 || mac.load1 >= 0 || mac.memUsed >= 0;
  mac.fetched = millis();
  mac.error   = mac.valid ? "" : "no reading";
  Serial.printf(
      "[mac] bat=%d%% %s load=%.2f mem=%d%% disk=%dGB display=%s idle=%ds\n",
      mac.batPct, mac.batState.c_str(), mac.load1, mac.memUsed, mac.diskFree,
      mac.display.c_str(), mac.idle);
  return mac.valid;
}

// --- per-core CPU -----------------------------------------------------------

// An M3 Ultra reports 28 logical cores, so 16 was low enough to truncate a real
// machine. The page fits its columns to whatever arrives now, and the array is
// two bytes a core.
static const int MAX_CORES = 32;

struct CpuStats {
  bool     valid   = false;
  int      n       = 0;
  int      core[MAX_CORES] = {0};   // busy percent, efficiency cores first
  int      avg     = -1;
  int      ecores  = 0;
  int      pcores  = 0;
  uint32_t fetched = 0;
  String   error;
};

CpuStats cpu;

static bool fetchCpu() {
  if (!net::online()) {
    cpu.error = "not connected";
    return false;
  }

  String payload;
  if (!net::get(hostUrl(MAC_PORT, "/cpu"), payload, cpu.error, HOST_TIMEOUT,
                HOST_TOKEN)) {
    return false;
  }

  JsonDocument doc;
  DeserializationError err = deserializeJson(doc, payload);
  if (err) {
    cpu.error = String("JSON: ") + err.c_str();
    return false;
  }

  cpu.n = 0;
  for (JsonVariant v : doc["cores"].as<JsonArray>()) {
    if (cpu.n >= MAX_CORES) break;      // a machine wider than the panel
    cpu.core[cpu.n++] = v.as<int>();
  }

  cpu.avg     = doc["avg"]    | -1;
  cpu.ecores  = doc["ecores"] | 0;
  cpu.pcores  = doc["pcores"] | 0;
  cpu.valid   = cpu.n > 0;
  cpu.fetched = millis();
  cpu.error   = cpu.valid ? "" : "no cores reported";
  return cpu.valid;
}

// --- notifications ------------------------------------------------------------
//
// The one thing here that travels towards the panel rather than away from the
// Mac. tools/mac_stats_server.py holds a single message; anything on that
// machine can post one — a Claude Code hook that wants an answer, a build that
// failed — and it goes up over whatever page is showing until a button
// acknowledges it.
//
// The id is what makes a message new, and nothing else could: the same words
// posted twice are two events worth raising, and a message still standing an
// hour later is the one already dismissed.

struct Notify {
  uint32_t id      = 0;      // last id seen; 0 until the first poll answers
  String   msg;
  String   kind    = "info"; // "info" / "warn" / "alert"
  uint32_t ttl     = 0;      // seconds on screen, 0 = until dismissed
  // The kind says what a banner is worth, and for the three the host can post
  // that is also enough to colour it. The pomodoro's are the exception: what
  // they are worth is the same every time, and what is worth saying in the
  // colour is which phase is starting — so that one carries its own hue and
  // this is where it is kept. 0 means the kind decides, as it did before.
  uint16_t tint    = 0;
  bool     showing = false;
  uint32_t raised  = 0;      // millis the banner went up
  uint32_t flash   = 0;      // ms of backlight flashing loop() owes it
  bool     synced  = false;  // has a baseline id been adopted?
  bool     local   = false;  // raised here rather than by the host
};

Notify notify;

// A message that arrived while the panel was off has usually already been dealt
// with by the person who saw it on the Mac, so the first poll adopts whatever
// is standing without raising it. Recent enough and it may still be waiting for
// someone — that one goes up.
static const int NOTIFY_STALE_ON_BOOT = 30;   // seconds

// How long a banner with no ttl of its own may hold the screen.
static const uint32_t NOTIFY_ALERT_MAX = 600;   // seconds

static bool fetchNotify() {
  if (!net::online()) return false;

  String payload, err;
  if (!net::get(hostUrl(MAC_PORT, "/notify"), payload, err, HOST_TIMEOUT,
                HOST_TOKEN)) {
    return false;
  }

  JsonDocument doc;
  if (deserializeJson(doc, payload)) return false;

  uint32_t id = doc["id"] | 0;
  if (id == notify.id) return false;      // the common case: nothing new
  notify.id = id;

  int age = doc["age"] | -1;
  bool first = !notify.synced;
  notify.synced = true;

  // Held aside until this turns out to be a message that actually goes up. The
  // fields used to be assigned before the two early returns below, so a reply
  // that was only being adopted as a baseline still overwrote the text of any
  // banner already standing — and now that the panel raises banners of its own
  // at boot, there is reliably one standing when the first poll lands.
  String msg = doc["msg"].as<String>();

  // An empty message is a retraction: the id moves so the panel notices, and
  // the banner comes down without anything replacing it. The host retracts only
  // what the host raised — a boot warning is not its to take down.
  if (!msg.length()) {
    if (!notify.local) notify.showing = false;
    return true;
  }

  if (first && !(age >= 0 && age <= NOTIFY_STALE_ON_BOOT)) return true;

  notify.msg   = msg;
  notify.kind  = doc["kind"] | "info";
  notify.ttl   = doc["ttl"] | 0;
  notify.tint  = 0;
  notify.local = false;

  notify.showing = true;
  notify.raised  = millis();
  notify.flash   = notify.kind == "alert" ? 2500 : 1000;
  Serial.printf("[notify] #%lu %s: %s\n", (unsigned long)notify.id,
                notify.kind.c_str(), notify.msg.c_str());
  return true;
}

// A banner the panel raises about itself, over the same mechanism the host uses
// and for the same reason: something happened that is worth being told rather
// than worth going to look for. The id is left alone so the next host message
// still reads as new.
static void raiseLocal(const char *kind, const String &msg, uint32_t ttl,
                       uint16_t tint = 0, uint32_t flash = 1000) {
  notify.msg     = msg;
  notify.kind    = kind;
  notify.ttl     = ttl;
  notify.tint    = tint;
  notify.local   = true;
  notify.showing = true;
  notify.raised  = millis();
  notify.flash   = flash;
  Serial.printf("[notify] local %s: %s\n", kind, msg.c_str());
}

// --- battery ----------------------------------------------------------------

static float batteryVolts() {
  uint32_t mv = 0;
  for (int i = 0; i < 8; i++) mv += analogReadMilliVolts(PIN_BAT_ADC);
  return (mv / 8) * 2.0f / 1000.0f;   // undo the 1:2 divider
}

// --- the pomodoro timer -------------------------------------------------------
//
// The one thing on this panel that is not a reading of somewhere else. Every
// other page is a window onto a machine — the sky, the Mac, the API's idea of
// how much of the week is left — and this one holds a state nothing off the
// board knows about.
//
// It is here rather than in a window on the Mac for the reason the clock is: a
// timer on the machine you are working on gets covered by the work, and one
// that raises a notification there is one more thing interrupting the screen
// you are trying to concentrate on. Beside the keyboard it is read the way a
// wall clock is, by looking at it — and when it does want you it has a
// backlight to flash and a screen nothing else is using.
//
// Twenty-five minutes of work, five off, a quarter of an hour after the fourth.
// Constants rather than settings: there is no keyboard on this board to change
// them with, and a length you can talk yourself into extending is not a timer.
static const uint32_t POMO_FOCUS_MS = 25UL * 60000UL;
static const uint32_t POMO_SHORT_MS =  5UL * 60000UL;
static const uint32_t POMO_LONG_MS  = 15UL * 60000UL;

static const uint8_t POMO_SET = 4;    // focus blocks before the long break

// How long the banner at the end of a phase stands before taking itself down.
// Long enough to still be up when you come back from the kitchen, short enough
// that the panel is not holding a screen for a message from an hour ago. The
// timer underneath keeps running either way, which is what separates this from
// an alert waiting on an answer.
static const uint32_t POMO_BANNER_S = 45;

// How long a phase that is loaded and waiting for you holds the panel on its
// own page. Only the automatic page choice reads this — see restPage() — and
// the bound is what keeps a break nobody came back from pinning the panel here
// all night. Ten minutes is twice the break it is usually waiting out.
static const uint32_t POMO_ARMED_MS = 10UL * 60000UL;

enum class Phase : uint8_t { Focus, Short, Long };

struct Pomo {
  Phase    phase   = Phase::Focus;
  bool     running = false;
  uint32_t endAt   = 0;                // millis it ends, while it is running
  uint32_t left    = POMO_FOCUS_MS;    // what is left of it, while it is not
  uint32_t armed   = 0;                // millis a waiting phase holds the page until
  uint8_t  done    = 0;                // focus blocks since the last long break
};

Pomo pomo;

static uint32_t phaseLen(Phase p) {
  return p == Phase::Focus ? POMO_FOCUS_MS
       : p == Phase::Short ? POMO_SHORT_MS
                           : POMO_LONG_MS;
}

// The ramp, used for what the ramp is for: a break is not a better or a worse
// thing than a block of work, it is a different one. Focus takes the hot end —
// the same magenta as this page's dot in the status bar — and the two rests the
// cool one, so the page changes colour end to end when the phase turns over and
// says so across a room with no word being read.
//
// The long break is violet rather than the blue it would fall on by walking the
// ramp, because blue is already the set card underneath. Three phases and the
// set are four readings on one page, and the ramp has exactly four colours to
// keep them apart with: doubling one would have made the page turn a single
// colour on the one phase where both halves of it have something to say.
static uint16_t phaseHue(Phase p) {
  return p == Phase::Focus ? C_MAGENTA : p == Phase::Short ? C_TEAL : C_VIOLET;
}

// Short, because the chip shares its line with a 168px countdown on a 320px
// panel. "LONG" rather than "LONG BREAK" for that and nothing else.
static const char *phaseChip(Phase p) {
  return p == Phase::Focus ? "FOCUS" : p == Phase::Short ? "BREAK" : "LONG";
}

// What is left, out of whichever of the two clocks is the live one: a deadline
// while it runs, a remainder while it does not. The difference is taken signed
// so that it survives millis() wrapping round.
static uint32_t pomoLeft() {
  if (!pomo.running) return pomo.left;
  int32_t d = (int32_t)(pomo.endAt - millis());
  return d > 0 ? (uint32_t)d : 0;
}

// A phase nobody has started yet, as against one paused partway through. The
// two want different things from the same hold — see pomoHold() — and they are
// also the difference between "ready" and "paused" on the card.
static bool pomoFresh() {
  return !pomo.running && pomo.left >= phaseLen(pomo.phase);
}

// Whether the timer is currently somebody's business: running, or loaded and
// still within the window it waits for a finger in. Two things read it, and for
// the same reason they read macAwake() — a timer running on the desk is a
// person at the desk, whatever the Mac says about it.
static bool pomoEngaged() {
  return pomo.running || (pomo.armed && (int32_t)(pomo.armed - millis()) > 0);
}

static void pomoLoad(Phase p, bool run) {
  pomo.phase   = p;
  pomo.left    = phaseLen(p);
  pomo.running = run;
  pomo.endAt   = millis() + pomo.left;
  pomo.armed   = run ? 0 : millis() + POMO_ARMED_MS;
}

// BOOT, pressed. One button for start, pause and resume, because they are one
// question asked at three moments: is this clock running or is it not.
static void pomoStartPause() {
  if (pomo.running) {
    pomo.left    = pomoLeft();
    pomo.running = false;
    // Paused by hand, so the panel stops holding this page for it: whoever
    // stopped the clock is standing right here and can choose their own page.
    pomo.armed   = 0;
  } else {
    pomo.endAt   = millis() + pomo.left;
    pomo.running = true;
    pomo.armed   = 0;
  }
  Serial.printf("[pomo] %s %s, %lus left\n", pomo.running ? "started" : "paused",
                phaseChip(pomo.phase), (unsigned long)(pomoLeft() / 1000));
}

// What follows what. A block of work earns its place in the set and hands over
// to a break; the fourth hands over to the long one, and a break hands back.
//
// `earned` is the difference between a phase that ran out and one skipped by
// hand. The count is a count of work done, and a block abandoned four minutes
// in did not happen — which is also why the skip is behind a hold.
static void pomoNext(bool earned) {
  Phase next;
  if (pomo.phase == Phase::Focus) {
    if (earned) pomo.done++;
    next = pomo.done >= POMO_SET ? Phase::Long : Phase::Short;
  } else {
    if (pomo.phase == Phase::Long) pomo.done = 0;
    next = Phase::Focus;
  }

  // A rest starts itself and a block of work does not, which is the one
  // asymmetry here and the useful one. Five minutes that begin when you notice
  // the banner are not five minutes off, so the break goes on the clock at
  // once; work that begins because a timer said so is work begun while you are
  // still in the kitchen, so the next block waits to be started. A phase
  // skipped by hand always waits — you are at the panel, and starting it is one
  // more press.
  pomoLoad(next, earned && next != Phase::Focus);
}

// BOOT, held. Two actions on one hold, told apart by what the timer is already
// doing — and the hint bar names the one it is about to do, so the pair is read
// off the screen rather than remembered. A phase with time spent on it goes
// back to full; one nobody has touched is skipped instead, which is how the
// break you do not want, or the block you already did away from the desk, gets
// out of the way. Behind a hold because both of them throw something away.
//
// This is the page where the backlight toggle is not on the hold. It is one
// press to the right on any of the other three, and a page whose whole job is
// one button had better spend that button on the timer.
static void pomoHold() {
  if (pomoFresh()) {
    pomoNext(false);
    Serial.printf("[pomo] skipped to %s\n", phaseChip(pomo.phase));
  } else {
    pomoLoad(pomo.phase, false);
    Serial.printf("[pomo] reset %s\n", phaseChip(pomo.phase));
  }
  pomo.armed = 0;
}

// BOOT, held past the first stop. The set is the one thing on this page the
// hold above cannot reach: `done` counts blocks that ran their full length, and
// pomoNext() clears it in exactly one place — the far side of the long break.
// Since a skip does not earn, a set abandoned at two could not be walked to
// that place either, and had no way back to the beginning short of pulling the
// cable. A poor answer on the one page holding a state of its own.
//
// Deeper on the same hold rather than on a button of its own, because it is the
// same kind of act as the two above it and throws away more than either: not a
// phase but everything since the last long break, back to a first block not yet
// started. The hint bar names it while the finger is still down, so the depth
// is read off the screen the way the rest of this page is.
static void pomoClearSet() {
  pomo.done = 0;
  pomoLoad(Phase::Focus, false);
  // Cleared for the reason pomoHold() clears it: whoever held the button down
  // for three seconds is standing at the panel and can pick their own page.
  pomo.armed = 0;
  Serial.println("[pomo] set cleared");
}

// Called every pass and from every page, because the timer is state rather than
// a page: a phase that ends while the Mac page is up has still ended. True on
// the pass one turns over, which is loop()'s cue to redraw and to send the
// panel back here.
static bool pomoTick() {
  if (!pomo.running || pomoLeft() > 0) return false;

  const Phase was = pomo.phase;
  pomoNext(true);

  // The alarm, over the mechanism the Mac raises its own by. This is the whole
  // reason a timer belongs on a panel with a backlight rather than in a window:
  // the end of a pomodoro is the one moment it has anything to say, and it has
  // to be able to say it to somebody who is looking at something else.
  //
  // Coloured for the phase that is starting rather than by severity, because
  // severity is the same every time and which phase is not. It is the one thing
  // worth taking in before the words are read: teal means get up, magenta means
  // sit down.
  String msg;
  if (was == Phase::Focus) {
    msg = pomo.phase == Phase::Long ? String("Four done. Take fifteen minutes")
                                    : String("Focus done. Five minutes off");
  } else {
    msg = String("Break over. Pomodoro ") + String(pomo.done + 1) + " of " +
          String(POMO_SET);
  }
  raiseLocal("pomo", msg, POMO_BANNER_S, phaseHue(pomo.phase), 3000);
  return true;
}

// --- automatic behaviour -----------------------------------------------------
//
// Two things the panel decides for itself: which page is worth showing, and how
// brightly to show it. Both for the same reason — a panel on a desk is read in
// glances, and the glance should land on whatever is currently true.
//
// Neither overrides a person. Any button hands control back for MANUAL_HOLD,
// and the automatic brightness gives way to the backlight toggle until the
// conditions that set it change.

// The flip clock leads, because it is where the panel spends its nights: the
// resting page below sends it there whenever the Mac goes dark, and a cycle that
// starts where it comes to rest is one you leave and come back to rather than
// one you go round.
//
// The pomodoro joins the end of the cycle rather than the middle, so that the
// three pages that were here keep the dots they had: the status bar colours
// each dot out of the ramp by position, and moving a page along would move the
// colour you have learned to press for it.
enum Page : uint8_t { PAGE_FLIP, PAGE_USAGE, PAGE_MAC, PAGE_POMO };
static const uint8_t PAGE_COUNT = 4;

static uint8_t page = PAGE_FLIP;

// The panel's own vitals, which are not a page. Every one of them answers "is
// this thing working", which is a question you ask on purpose after noticing
// something wrong — never one you answer in a glance. As a page it cost a press
// on every trip round the cycle to skip past figures that had not moved: three
// of them are constants, and the two network ones read "--" whenever the link
// is the USB cable, which is nearly always. Held behind IO14 instead, it keeps
// every field it had and costs nothing to the reader who does not want it.
static bool vitalsUp = false;

static bool     autoPages   = true;   // 'A' over serial switches it off
static uint32_t manualUntil = 0;      // auto keeps out of the way until here
static int8_t   autoReturn  = -1;     // page to fall back to, -1 = none

static const uint32_t MANUAL_HOLD = 120000UL;   // two minutes

// A press means someone is driving. Auto stops choosing pages for a while, and
// forgets where it meant to return to — that plan was made for a panel nobody
// was watching.
static void handOverToUser() {
  manualUntil = millis() + MANUAL_HOLD;
  autoReturn = -1;
}

static bool userDriving() { return manualUntil && millis() < manualUntil; }

// Busy enough that the Mac page is the one worth being on — it carries the core
// columns, so a loaded machine arrives as a shape rather than a number. Load is
// measured
// against the core count because that is the only way the number means the same
// thing on two machines; three quarters is where a Mac stops feeling idle
// without one compile tripping it.
static bool macBusy() {
  return mac.valid && mac.ncpu > 0 && mac.load1 >= mac.ncpu * 0.75f;
}

// A window close enough to its limit to change what you do next.
static bool usageTight() {
  return usage.valid && (usage.h5 >= 85 || usage.d7 >= 85);
}

// Where the panel settles when nothing is happening, which is the other half of
// what the Mac going away is worth saying. The two states want different pages
// because they are read by a person doing different things: a dark Mac means
// nobody is working, and the only field on this panel that is still moving is
// the clock; a Mac whose screen just came on means somebody sat down, and the
// first thing that changes what they do next is how much of the window is left.
//
// The clock it rests on is the flip one rather than the merged clock-and-weather
// page, and the two halves of that sentence above are why. Nobody is working, so
// nothing on the page is going to be read closely — it is going to be caught
// sideways on the way past, from the far side of a dark room, at the quarter
// brightness the same reading has already dimmed the panel to. That is a job for
// four cards 88px tall and almost nothing else, and it is not a job for a date, a
// place, and a line of forecast in 16px type. Every one of those is still one
// press to the right, for whoever wants them.
//
// This is the resting page rather than a raised one — it replaces where auto
// falls back to, instead of borrowing the screen for a while and handing it back.
//
// Takes the state rather than reading macAwake() itself, so the page and the
// crossing that asked for it cannot come from two different readings: the test
// runs off a staleness clock, and it can turn over between two calls a line
// apart.
// A running timer outranks both, and is the only page here chosen by something
// the panel was told rather than something it observed. Somebody pressed a
// button to start it, which is a stronger statement about what is worth showing
// than any reading off the Mac — and the minutes left are what they pressed it
// to be able to see. It gives the page back when the clock stops, or ten
// minutes after a phase that is waiting to be started gives up waiting.
static uint8_t restPage(bool awake) {
  if (pomoEngaged()) return PAGE_POMO;
  return awake ? PAGE_USAGE : PAGE_FLIP;
}

// Set when something has decided the panel belongs back at its resting page:
// the Mac crossing between dark and in use, or a banner that ran out its own
// ttl with nobody answering it. It lives out here rather than inside
// autoPickPage() because the second of those is noticed in loop(), a long way
// from the function that acts on it. Either way it is a request, not a move —
// it waits for a hold or a banner to be out of the way, and two requests
// arriving behind one of those collapse into arriving once.
static bool restWanted = false;

static void autoGoTo(uint8_t want) {
  if (page == want) return;
  if (autoReturn < 0) autoReturn = page;
  page = want;
  Serial.printf("[auto] to page %u\n", page);
}

// Called once a pass; true when it moved.
//
// Each condition raises its page once and is then marked as shown, so a page
// re-chosen for as long as the condition holds is not a page you cannot leave.
// The mark is cleared by the condition passing, never by time: something still
// true when a banner comes down or a hold expires is still worth showing then,
// while a spike that came and went in the meantime has already cleared its own
// mark and stays quiet.
//
// Arriving back at the resting page waits its turn the same way, and collapses
// while it waits: a machine that woke and went back to sleep behind a banner has
// moved the resting page twice, and only where it ended up is worth arriving on.
// Both things that ask for it — the Mac crossing, and a banner that timed out
// unanswered — are asking for the same arrival, so two of them are still one.
static bool autoPickPage() {
  static bool busyShown = false, tightShown = false;
  static int8_t lastAwake = -1;     // -1 until the first reading decides

  bool   awake = macAwake();
  int8_t state = awake ? 1 : 0;
  if (state != lastAwake) {
    lastAwake = state;
    restWanted = true;
  }

  // Neither alert condition survives the Mac going quiet: both are made of
  // numbers that stopped arriving, so a full window or a loaded machine found
  // after that is a reading from before it went. Leaving the clock for one
  // would be the panel presenting old news as if it had just happened — and it
  // would be doing it at the hours the clock is the only thing on the desk
  // still worth showing.
  //
  // Staleness is the whole of the reason for the busy one, which is why it is
  // against macAnswering() rather than the resting test: a machine with its
  // screens off is nobody's idea of in use, but a build running on it is
  // running now, and the columns that show it are worth raising for whoever
  // comes back to find out what it did.
  //
  // The tight one is against the resting test instead, because what it raises
  // is the page the panel is meant to have left. A window filling up is only
  // news to somebody who is about to spend it, and it is the one condition here
  // that stays true for hours — long enough to hold the panel on a bright page
  // all evening over a threshold crossed while nobody was in the room. Awake,
  // it still does its job: the resting page is usage anyway, and the raise is
  // what brings you back to it from wherever you had left the panel.
  bool answering = macAnswering();
  bool busy = answering && macBusy(), tight = awake && usageTight();

  // Neither of them interrupts a timer that is somebody's business. Both borrow
  // the screen for something the panel noticed by itself, and the timer is the
  // one thing on this panel that was asked for out loud — the minutes left are
  // what the button was pressed to be able to see. The full window is the
  // sharper case: it stays true for hours, so a raise landing inside a block of
  // work would hold the panel off the countdown for the rest of the block and
  // give it back some time after the banner had already said the block was
  // over.
  //
  // Against pomoEngaged() rather than pomo.running, because a phase loaded and
  // waiting for a finger needs the page more than a running one does, not less.
  // A running clock only wants watching; a waiting one wants pressing, and BOOT
  // is the timer's button on this page alone — anywhere else in the cycle it is
  // the refresh. So the gap between the two tests was the whole of the break:
  // the panel came back to rest on the timer when the banner went down, was
  // pulled off it on the very next pass, and the press meant to start the next
  // block landed on a page that answered it by refetching something.
  //
  // Cleared rather than stepped around, so that the marks below clear with
  // them. A condition still true when the timer lets go is raised then, exactly
  // as one still true when a hold expires is: as far as this is concerned, the
  // timer letting go is the condition arriving. Letting go is the clock
  // stopping, a phase paused by hand — pomoStartPause() disarms it, because
  // whoever paused it is standing here — or a phase nobody came back to start
  // running out its ten minutes of holding the page.
  if (pomoEngaged()) busy = tight = false;

  if (!busy)  busyShown = false;
  if (!tight) tightShown = false;

  // Not while a banner is up: the page underneath is covered, and moving it
  // would only mean the dismissal lands somewhere unexpected.
  if (!autoPages || userDriving() || notify.showing) return false;

  uint8_t was = page;
  if (restWanted) {
    // Straight to the page rather than through autoGoTo: this is the floor
    // moving, so there is nothing left to come back to, and a return plan made
    // while the Mac was up would drag the panel off the clock after it went.
    restWanted = false;
    autoReturn = -1;
    page = restPage(awake);
    Serial.printf("[auto] resting on page %u, mac %s\n", page,
                  awake              ? "awake"
                  : !macAnswering()  ? "asleep"
                  : macScreensOn()   ? "untended"
                                     : "dark");
  } else if (tight && !tightShown) {
    // Usage wins the tie: a full window stops the work, a busy machine only
    // slows it down.
    tightShown = true;
    autoGoTo(PAGE_USAGE);
  } else if (busy && !busyShown) {
    busyShown = true;
    autoGoTo(PAGE_MAC);
  } else if (!busy && !tight && autoReturn >= 0) {
    page = (uint8_t)autoReturn;
    autoReturn = -1;
    Serial.printf("[auto] back to page %u\n", page);
  }
  return page != was;
}

// --- backlight ---------------------------------------------------------------

// Brightness is one of the panel's two answers to "is anyone at the Mac" — the
// resting page is the other — and the only thing it answers. It is the one
// channel here that carries across a room: you take it
// in without reading anything, from an angle, out of the corner of an eye —
// which is more than can be said for a four-letter word in 16px type at the
// top left corner, and that word is what this replaces.
//
// 75% and 25% of full duty. Lit rather than blanked at the low end for the
// reason the panel has always been lit: the hours the Mac is away are exactly
// the hours nothing else on the desk is showing the time, so asleep has to
// stay readable. It lands within a few counts of the night level this used to
// dim to after sunset, so the dark end is a known quantity.
static const uint8_t BL_AWAKE = 191, BL_ASLEEP = 64;

// The attention flash goes to full, above either resting level, so that it
// reads as a flash from whichever one it interrupts.
static const uint8_t BL_FLASH = 255;

static uint8_t backlight = BL_AWAKE;   // what the panel is lit at right now
static int16_t blManual  = -1;         // -1 = follow the rules below

// Sunset used to move this instead, which was the wrong axis twice over. It
// dimmed the panel at eight in the evening while you were still sitting there
// working, and left it bright all night whenever the sky was the only thing
// that had changed. What the level is worth saying is whether anyone is over
// there — and that dims the panel when you go to bed, because the screen going
// dark is what going to bed looks like, without the panel having to know the
// hour.
//
// The sunrise and sunset the forecast was fetched for went with it. Nothing
// reads them now, and this project does not keep readings that nothing reads.
//
// A running timer counts as somebody being here even with the Mac dark, and it
// is better evidence than anything the Mac reports: the machine can be woken by
// a notification, while a pomodoro only starts because a finger started it.
// Reading away from the keyboard is exactly the case, and dimming the panel for
// the twenty-five minutes it was asked to count would be the one reading it
// cannot afford to lose.
static uint8_t autoBacklight() {
  return (macAwake() || pomoEngaged()) ? BL_AWAKE : BL_ASLEEP;
}

// A new notification flashes the panel as well as drawing the banner: the
// banner is only seen by someone already looking at it, and the flashing is
// what turns the head of someone who isn't.
static uint32_t flashUntil = 0, flashStep = 0;
static bool     flashDark  = false;

// The manual toggle holds until the automatic level would have changed anyway:
// turning the panel up to read something at night should not leave it blazing
// until morning.
static void applyBacklight() {
  static uint8_t lastAuto = BL_AWAKE;

  uint8_t want = autoBacklight();
  if (want != lastAuto) {
    lastAuto = want;
    blManual = -1;
  }

  uint8_t level = blManual >= 0 ? (uint8_t)blManual : want;
  if (level == backlight) return;

  backlight = level;
  // Held back mid-flash: the flash owns the pin until it finishes, and picks
  // the new level up when it hands it back.
  if (!flashUntil) analogWrite(TFT_BL, backlight);
  Serial.printf("[backlight] %u\n", backlight);
}

// Called every pass: runs the flash if one is owed, and otherwise keeps the
// panel at whatever the rules currently ask for. Driven from loop() rather than
// a delay() so a fetch or a redraw can land in the middle of a flash.
static void updateBacklight() {
  if (notify.flash) {
    flashUntil = millis() + notify.flash;
    flashStep  = 0;
    notify.flash = 0;
  }

  applyBacklight();

  if (!flashUntil) return;

  if (millis() > flashUntil || !notify.showing) {
    flashUntil = 0;
    flashDark = false;
    analogWrite(TFT_BL, backlight);
  } else if (millis() >= flashStep) {
    flashStep = millis() + 130;
    flashDark = !flashDark;
    analogWrite(TFT_BL, flashDark ? 8 : BL_FLASH);
  }
}

// --- cards ---------------------------------------------------------------------
//
// The flip clock's cards, made into something the pages of small print can be
// built out of. Same two tones, same rounded corners; what changes is the
// strength. A card carrying an 88px digit can be its hue at full and still be
// legible from the doorway, while a card carrying a bar, a percentage and a line
// of small print has to sit *behind* all three — so these are the same hue at a
// quarter of it. Enough to say which card you are looking at, not enough to
// argue with what is written on it.
//
// Text on a card is drawn transparent throughout, and that is the reason the
// two-tone body is affordable at all: an opaque smooth font paints its whole
// line box in one background colour, so a card with a seam through it would box
// every string in the wrong half's shade. Blended against whatever is already in
// the sprite, a string can cross the seam without noticing it. The sprite is
// cleared and rebuilt every frame, so there is nothing stale underneath to blend
// with.

// A card runs to 4px of the screen edge and holds its contents 6px inside that,
// which puts a line of text back on the 10px margin the pages used before there
// were cards to sit on. That is not a coincidence and it is the point: the
// geometry on these pages was measured against real strings — the longest
// weekday and month, a memory figure at 100% — and a card that ate into it would
// pay for itself by dropping a field on the longest day of the year.
static const int16_t CARD_R = 6, CARD_PAD = 6;
static const int16_t CARD_X = 4, CARD_W = SCR_W - 8;

// The body every card here is made of: the hue across the top, a darker cast
// below the midline, rounded at all four corners and square across the seam. The
// lower half rounds its own upper corners too, which would notch the seam, so
// those are squared off again — the card is at full width across its middle, so
// the patch lands entirely inside it.
static void cardBody(int16_t x, int16_t y, int16_t w, int16_t h, int16_t r,
                     uint16_t top, uint16_t bot) {
  const int16_t half = h / 2;
  fb.fillRoundRect(x, y, w, h, r, top);
  fb.fillRoundRect(x, y + half, w, h - half, r, bot);
  fb.fillRect(x, y + half, w, r, bot);
}

// A card for a page of numbers. The edge is the same hue at a strength the body
// is not, because at a quarter the card and the background are close enough that
// the corners are the only thing saying where it ends.
static void panelCard(int16_t x, int16_t y, int16_t w, int16_t h, uint16_t hue) {
  cardBody(x, y, w, h, CARD_R, shade(hue, 26), shade(hue, 18));
  fb.drawRoundRect(x, y, w, h, CARD_R, shade(hue, 62));
}

// A label in a lozenge of its card's hue: the small-type answer to a flip card,
// and the one place on these pages where a hue is at full strength. Dark text on
// saturated colour rather than the other way round, which is what keeps a 16px
// label off the body of the same hue behind it. Returns the right edge — every
// row here is laid out from its label outwards.
static int16_t chip(int16_t x, int16_t cy, const char *label, uint16_t hue) {
  const int16_t w = fb.textWidth(label) + 12, h = 18;
  fb.fillRoundRect(x, cy - h / 2, w, h, 5, hue);
  fb.setTextDatum(MC_DATUM);
  fb.setTextColor(C_BG);
  fb.drawString(label, x + w / 2, cy);
  return x + w;
}

// --- shared chrome ----------------------------------------------------------

// Label left, value right, within a column. Used by the Mac page's grid and the
// vitals overlay. Values that would run into the label are clipped — a long SSID
// is otherwise wide enough to overlap it.
//
// The label takes its card's hue on the Mac page and stays dim in the overlay,
// which is the difference between the two. Three cards in a row are told apart
// at a distance the words on them cannot be read from, and the label repeating
// the hue is what carries that; the overlay is one card of sixteen fields nobody
// reads from across the room, and colouring every label there would only be
// decoration.
static void row(int16_t x, int16_t w, int16_t y, const char *label,
                const String &value, uint16_t color,
                uint16_t labelColor = C_DIM) {
  fb.setTextDatum(TL_DATUM);
  fb.setTextColor(labelColor);
  fb.drawString(label, x, y);

  int16_t avail = w - fb.textWidth(label) - 8;
  String shown = value;
  if (fb.textWidth(shown) > avail) {
    while (shown.length() > 1 && fb.textWidth(shown + "..") > avail) {
      shown.remove(shown.length() - 1);
    }
    shown += "..";
  }

  fb.setTextDatum(TR_DATUM);
  fb.setTextColor(color);
  fb.drawString(shown, x + w, y);
}

// --- the bar row -----------------------------------------------------------
//
// The shape both the usage gauges and the Mac's charge are made of: a chip, a
// track, and the figure the track is a picture of. Shared so that the two pages
// line up — and so that they go on lining up, since the track is fitted to
// whatever room the figure leaves rather than to a width written down twice.
//
// The fill is the caller's, because the two mean different things: the usage
// gauge runs a cool-to-hot gradient across a cost climbing toward its limit,
// while a charge bar is one flat colour and a full one is the good end.

static const int16_t BAR_H = 14;

struct BarTrack { int16_t x, w; };

static BarTrack barRow(int16_t cx, int16_t cw, int16_t cy, const char *label,
                       uint16_t hue, const String &value, uint16_t valueColor) {
  useFont(UiFont16);
  const int16_t left = chip(cx + CARD_PAD, cy, label, hue) + 10;

  useFont(UiFont24);
  int16_t right = cx + cw - CARD_PAD;
  if (value.length()) {
    fb.setTextDatum(MR_DATUM);
    fb.setTextColor(valueColor);
    fb.drawString(value, right, cy);
    right -= fb.textWidth(value) + 10;
  }

  const BarTrack t = {left, (int16_t)(right - left)};
  if (t.w > 0) {
    // Darker than the body it is cut into, so it reads as a well the fill sits
    // in rather than as a second card lying on the first.
    fb.fillRect(t.x, cy - BAR_H / 2, t.w, BAR_H, shade(hue, 10));
  }
  return t;
}

static void drawStatusBar(const struct tm *now, bool timeValid) {
  fb.fillRect(0, 0, SCR_W, BAR_TOP, C_BAR);

  useFont(UiFont16);
  fb.setTextDatum(ML_DATUM);

  // The link name doubles as the connectivity indicator: "USB" when the host
  // bridge is answering, "WiFi" when the radio is carrying it instead.
  fb.setTextColor(net::online() ? C_OK : C_ERR, C_BAR);
  fb.drawString(net::viaName(), 6, BAR_TOP / 2);

  // Beside the link rather than anywhere else on the bar, because the two are
  // read together: the link says whether the panel can still see the Mac, and
  // this says what it sees. Dim, at the weight of the hint bar — it is a
  // standing fact about the room, not a warning, and it should be findable
  // without being the first thing the eye lands on.
  if (const char *why = macRestLabel()) {
    fb.setTextColor(C_DIM, C_BAR);
    fb.drawString(why, 6 + fb.textWidth(net::viaName()) + 7, BAR_TOP / 2);
  }

  if (timeValid) {
    char stamp[16];
    strftime(stamp, sizeof(stamp), "%a %d %b", now);
    fb.setTextDatum(MR_DATUM);
    fb.setTextColor(C_TEXT, C_BAR);
    fb.drawString(stamp, SCR_W - 6, BAR_TOP / 2);
  }

  // Page dots, centred, each in the hue of the page it stands for — the ramp in
  // the order the flip clock's own cards are in, so the dot you leave and the
  // page you land on are the same colour.
  //
  // The lit one keeps its second job: cyan when the panel may pick the page
  // itself, warm while a button press has it holding off, white when automatic
  // selection is switched off for good. Three signals in three dots, and they do
  // not collide — hue says which page each dot is, brightness says which one you
  // are on, and the colour of the one you are on says who is choosing.
  uint16_t live = !autoPages ? C_TEXT : userDriving() ? C_WARM : C_ACCENT;
  for (uint8_t i = 0; i < PAGE_COUNT; i++) {
    int16_t x = SCR_W / 2 - (PAGE_COUNT - 1) * 6 + i * 12;
    fb.fillCircle(x, BAR_TOP / 2, 3, i == page ? live : shade(C_FLIP[i], 55));
  }
}

static void drawHintBar(const char *left, const char *right) {
  fb.fillRect(0, BODY_BOT, SCR_W, BAR_BOTTOM, C_BAR);
  useFont(UiFont16);
  fb.setTextColor(C_DIM, C_BAR);
  fb.setTextDatum(ML_DATUM);
  fb.drawString(left, 6, BODY_BOT + BAR_BOTTOM / 2);
  fb.setTextDatum(MR_DATUM);
  fb.drawString(right, SCR_W - 6, BODY_BOT + BAR_BOTTOM / 2);
}

// --- the notification banner -------------------------------------------------

// The wrap itself lives in layout.h, shared with tests/layout_test.cpp. This is
// the seam: the measurement it cannot do for itself, in whatever font is loaded.
static int16_t measureText(const char *s) { return fb.textWidth(s); }

static uint16_t notifyColor() {
  if (notify.tint) return notify.tint;
  if (notify.kind == "alert") return C_ERR;
  if (notify.kind == "warn")  return C_WARM;
  return C_ACCENT;
}

static const char *notifyHeading() {
  if (notify.kind == "pomo")  return "POMODORO";
  if (notify.kind == "alert") return "ALERT";
  if (notify.kind == "warn")  return "WARNING";
  return "NOTE";
}

static void drawBanner() {
  const int16_t x = 8, y = BODY_TOP + 6;
  const int16_t w = SCR_W - 16, h = BODY_BOT - y - 6;
  const uint16_t col = notifyColor();

  // The same card the pages are built from, in the colour the kind has already
  // chosen. The severity ramp rather than the position one, and that is the
  // point: everywhere else a card's hue says which reading this is, and here it
  // says how much this matters — which is the only thing about a banner worth
  // knowing before the words are read.
  panelCard(x, y, w, h, col);

  // A stripe down the edge, so that much reads before even the colour of the
  // card has been taken in. Inset and rounded, because a square one run to the
  // card's full height would poke out through its corners.
  fb.fillRoundRect(x + 3, y + 4, 5, h - 8, 2, col);

  const int16_t tx = x + 16, tw = w - 24;

  useFont(UiFont16);
  fb.setTextDatum(TL_DATUM);
  fb.setTextColor(col);
  fb.drawString(notifyHeading(), tx, y + 7);

  // Anything left standing for a while was raised while nobody was looking;
  // saying so is the difference between "just now" and "since lunchtime".
  uint32_t age = (millis() - notify.raised) / 1000;
  if (age >= 10) {
    fb.setTextDatum(TR_DATUM);
    fb.setTextColor(C_DIM);
    fb.drawString(age < 90 ? String(age) + "s ago" : String(age / 60) + "m ago",
                  x + w - 8, y + 7);
  }

  // Big enough to read from across the room when the message is short, dropping
  // a size when it is long enough to need three lines instead of two. Decided
  // by wrapping and seeing, not by comparing the width against two lines' worth
  // of pixels: greedy wrapping leaves a ragged edge, so a string narrower than
  // that can still need the smaller font.
  String lines[3];
  bool cut = false;
  useFont(UiFont24);
  int n = wrapText(notify.msg, tw, 2, lines, measureText, &cut);
  if (cut) {
    useFont(UiFont16);
    n = wrapText(notify.msg, tw, 3, lines, measureText);
  }

  const int16_t top = y + 30, avail = h - 36;
  int16_t lh = fb.fontHeight() + 2;
  int16_t ty = top + (avail - n * lh) / 2;
  if (ty < top) ty = top;

  fb.setTextDatum(TL_DATUM);
  fb.setTextColor(C_TEXT);
  for (int i = 0; i < n; i++) fb.drawString(lines[i], tx, ty + i * lh);
}

// --- page 1: the flip clock --------------------------------------------------
//
// The same two readings as the page after it — the time, and how warm it is —
// with everything else taken away. No date, no place, no line of forecast: this
// is where the panel comes to rest once the Mac's screens go dark, and the
// hours it spends there are the hours nobody is reading anything. What a page
// has to do at a quarter brightness from across a dark room is be legible at a
// glance from the doorway, and four split-flap cards 88px tall do that where a
// row of 16px small print does not.
//
// The temperature is the one other thing worth carrying that far, because it is
// the only reading here that changes what you do next — whether to open a window
// on the way past. It sits under the cards at a size you have to come closer to
// read, which is the right size for it: it is the second question, not the first.
// Everything the merged clock page carries and this one does not — the day, the
// sky, the place, how stale the reading is — is still one press away.

static const int16_t FLIP_W = 68, FLIP_H = 88, FLIP_TOP = 24, FLIP_R = 8;
static const int16_t FLIP_PAIR = 6, FLIP_COLON = 22;

static const int16_t FLIP_MID = FLIP_TOP + FLIP_H / 2;
static const int16_t FLIP_HALF = FLIP_H / 2;

// TFT_eSPI hangs a middle-datum string half the font's line height either side
// of the y it is given, and this face carries 47px of descender that no digit
// uses. Centring the ink rather than the box therefore means asking for a y a
// few pixels below the middle of the card. Measured off flip88.vlw rather than
// guessed: a 146px line box whose digits all sit between y=37 and y=100, so
// their centre is 4px above the box's.
static const int16_t FLIP_INK = 4;

// Left edge of card i. The 7px of margin either side is what falls out of four
// cards, the gap inside each pair, and the wider one the colon sits in:
// 4*68 + 2*6 + 22 comes to 306 of the 320 there are.
static int16_t flipX(int i) {
  const int16_t span = 4 * FLIP_W + 2 * FLIP_PAIR + FLIP_COLON;
  return (SCR_W - span) / 2 + i * (FLIP_W + FLIP_PAIR) +
         (i >= 2 ? FLIP_COLON - FLIP_PAIR : 0);
}

// One whole card: the two-tone body, the digit over it, and the seam over that.
// Drawn through whatever viewport is in force, which is how the leaves below get
// their shape. `lit` scales the colour — 100 is a card at rest, less is one in
// flight, and a card caught mid-fold gets a deeper cast still. That shading, and
// the clipping below, are between them the whole of what makes a rectangle read
// as a card folding over.
//
// Expects FlipFont88 already loaded; the caller does it once for all four rather
// than paying loadFont's allocations per card per frame.
static void flipFace(int16_t x, uint16_t hue, char d, uint8_t lit) {
  cardBody(x, FLIP_TOP, FLIP_W, FLIP_H, FLIP_R, shade(hue, lit),
           shade(hue, (uint8_t)(lit * 72 / 100)));

  // Transparent rather than boxed. The glyph crosses the seam onto two different
  // colours, so there is no one background behind it to paint; the one-argument
  // setTextColor is what asks TFT_eSPI to blend each anti-aliased edge pixel
  // against whatever is already in the sprite instead.
  fb.setTextDatum(MC_DATUM);
  fb.setTextColor(shade(C_TEXT, lit));
  fb.drawString(String(d), x + FLIP_W / 2, FLIP_MID + FLIP_INK);

  // Last, and over the digit: the line across the face is the whole of what says
  // "card" rather than "box", and a split-flap's split runs through the number.
  fb.drawFastHLine(x, FLIP_MID - 1, FLIP_W, C_BG);
  fb.drawFastHLine(x, FLIP_MID, FLIP_W, shade(hue, 35));
}

// --- the fold ----------------------------------------------------------------
//
// A card that changes does not simply become the new digit. The old one folds
// down over the fresh half already waiting underneath, and then the new lower
// half swings up out of the seam to meet it.
//
// Nothing here rotates a bitmap. The leaf is the same card face drawn through a
// viewport that closes onto the seam and opens again below it, dimming as it
// goes — clipping and shading, which at this size is what a fold looks like. It
// costs three card draws on the one or two cards actually moving, and nothing at
// all on the rest.
//
// This is the one thing on the panel that has to be drawn as an animation rather
// than as a state, so it is also the one thing that wants a frame faster than
// the once a second everything else is content with. See redrawEvery().
static const uint32_t FLIP_MS = 360, FLIP_FRAME_MS = 40;

static char     flipShown[4] = {0};   // what the four cards are showing
static char     flipFrom[4]  = {0};   // what each of them last folded away from
static uint8_t  flipMask     = 0;     // which are in flight, one bit per card
static uint32_t flipStart    = 0;     // 0 when nothing is

// True from the moment a card starts moving until the frame that puts them all
// back down — which is one frame past the end of the fold, and deliberately so.
// Ending it on the elapsed time instead leaves the settled face to be drawn at
// the ordinary rate, and the gate has just been told it may wait a second: the
// last leaf, nine tenths of the way over and still dimmed, holds the screen for
// the whole of it. pageFlip() is what clears flipStart, on the frame it draws
// the cards at rest, so asking whether it has done that yet is the right
// question and the elapsed time is not.
static bool flipping() { return flipStart != 0; }

static void clipTo(int16_t x, int16_t y, int16_t w, int16_t h) {
  fb.setViewport(x, y, w, h, false);   // false = coordinates stay absolute
}

// The strip under the cards: how warm it is, and what that feels like. Small on
// purpose — see the note at the top of the page.
static void flipWeather(int16_t cy) {
  if (!weather.valid) {
    useFont(UiFont16);
    fb.setTextDatum(MC_DATUM);
    fb.setTextColor(C_ERR, C_BG);
    fb.drawString(weather.error.length() ? weather.error : String("loading..."),
                  SCR_W / 2, cy);
    return;
  }

  // Rounded to the degree, as on the clock page and for the same reason: the
  // tenth is not a figure anybody reads off a panel across a room.
  const String air  = String((int)lroundf(weather.temp))  + "°";
  const String feel = String((int)lroundf(weather.feels)) + "°";
  const char  *tag  = "feels like";

  // Measured in both faces before anything is drawn, because the whole group is
  // centred and its width is not known until every piece of it has been asked.
  useFont(UiFont24);
  const int16_t wAir = fb.textWidth(air);
  useFont(UiFont16);
  const int16_t wTag = fb.textWidth(tag), wFeel = fb.textWidth(feel);

  const int16_t GAP = 14;
  int16_t x = (SCR_W - (wAir + GAP + 2 + GAP + wTag + 6 + wFeel)) / 2;

  useFont(UiFont24);
  fb.setTextDatum(ML_DATUM);
  fb.setTextColor(tempColor(weather.temp), C_BG);
  fb.drawString(air, x, cy);
  x += wAir + GAP;

  // Drawn rather than typed, as on the usage and Mac pages: make_vlw.py bakes
  // printable ASCII and the degree sign, so a middle dot would come out blank.
  fb.fillCircle(x + 1, cy, 1, C_DIM);
  x += 2 + GAP;

  useFont(UiFont16);
  fb.setTextColor(C_DIM, C_BG);
  fb.drawString(tag, x, cy);
  x += wTag + 6;

  // The label stays dim and the figure carries the colour, so that the gap
  // between 31° and 38° is what the line is for.
  fb.setTextColor(tempColor(weather.feels), C_BG);
  fb.drawString(feel, x, cy);
}

static void pageFlip(const struct tm *now, bool timeValid) {
  // Dashes rather than a blank face before NTP lands: an empty card would read
  // as a panel that had not finished drawing.
  char face[5] = "----";
  if (timeValid) strftime(face, sizeof(face), "%H%M", now);

  // A change is noticed here rather than in loop(), because here is where the
  // clock is already being read. At 1 Hz the fold starts within a second of the
  // minute turning, which is closer than a real split-flap board manages.
  static bool seeded = false;
  uint8_t moved = 0;
  for (int i = 0; i < 4; i++) {
    if (face[i] == flipShown[i]) continue;
    flipFrom[i]  = flipShown[i];
    flipShown[i] = face[i];
    moved |= 1 << i;
  }

  // The first draw of all only ever seeds the cards. Later ones fold whatever
  // has changed, including the several that will have changed while the panel
  // was on another page — arriving to find the clock catching up to itself is
  // what a split-flap board does, and it is the right thing to be looking at.
  if (moved && seeded) {
    flipMask  = moved;
    flipStart = millis();
  }
  seeded = true;

  uint32_t elapsed = flipStart ? millis() - flipStart : FLIP_MS;
  if (elapsed >= FLIP_MS) { flipStart = 0; flipMask = 0; }

  useFont(FlipFont88);

  for (int i = 0; i < 4; i++) {
    const int16_t  x   = flipX(i);
    const uint16_t hue = C_FLIP[i];

    if (!(flipMask & (1 << i))) {
      flipFace(x, hue, flipShown[i], 100);
      continue;
    }

    // What the fold happens over: the new digit's upper half already in place,
    // the old one's lower half still standing until the leaf comes down to it.
    flipFace(x, hue, flipShown[i], 100);
    clipTo(x, FLIP_MID, FLIP_W, FLIP_H - FLIP_HALF);
    flipFace(x, hue, flipFrom[i], 100);
    fb.resetViewport();

    const float t = (float)elapsed / FLIP_MS;
    if (t < 0.5f) {
      // First half: the old upper leaf closing onto the seam and darkening as
      // it turns away from the light.
      const float p = t * 2;
      const int16_t h = (int16_t)(FLIP_HALF * (1 - p));
      if (h > 0) {
        clipTo(x, FLIP_MID - h, FLIP_W, h);
        flipFace(x, hue, flipFrom[i], (uint8_t)(100 - 45 * p));
        fb.resetViewport();
      }
    } else {
      // Second half: the new lower leaf opening back out of it, brightening as
      // it comes round to face you.
      const float p = t * 2 - 1;
      const int16_t h = (int16_t)(FLIP_HALF * p);
      if (h > 0) {
        clipTo(x, FLIP_MID, FLIP_W, h);
        flipFace(x, hue, flipShown[i], (uint8_t)(55 + 45 * p));
        fb.resetViewport();
      }
    }
  }

  // The colon, which is drawn rather than set because it belongs to neither pair
  // of cards and would have to be a fifth one to be typed. It softens on the odd
  // second and comes back on the even, and that is the page's only answer to "is
  // this thing still running" — everything else on it holds still for a minute
  // at a time, which is a long while to look at a panel and wonder.
  const uint16_t dot = (timeValid && (now->tm_sec & 1)) ? C_DIM : C_TEXT;
  const int16_t  cx  = (flipX(1) + FLIP_W + flipX(2)) / 2;
  fb.fillCircle(cx, FLIP_MID - 16, 4, dot);
  fb.fillCircle(cx, FLIP_MID + 16, 4, dot);

  flipWeather(133);
}

// --- page 2: Claude Code usage ----------------------------------------------

// Cool-to-hot ramp across a filled bar, matching the status line in the
// terminal: green while there is room, red as the window fills.
static uint16_t rampColor(float t) {
  uint8_t r, g;
  if (t < 0.5f) { r = (uint8_t)(t * 2 * 255); g = 255; }
  else          { r = 255; g = (uint8_t)((1 - t) * 2 * 255); }
  return ((r & 0xF8) << 8) | ((g & 0xFC) << 3);
}

static uint16_t severityColor(int pct) {
  if (pct >= 85) return C_ERR;
  if (pct >= 60) return C_WARM;
  return C_OK;
}

// "2d 5h" / "3h 05m" / "12m" — a span at the precision that still matters at
// its size. Empty for anything non-positive, so callers can test the result
// rather than the input.
static String spanText(long seconds) {
  if (seconds <= 0) return "";
  long dd = seconds / 86400, hh = (seconds % 86400) / 3600,
       mm = (seconds % 3600) / 60;
  char buf[16];
  if (dd > 0)      snprintf(buf, sizeof(buf), "%ldd %ldh", dd, hh);
  else if (hh > 0) snprintf(buf, sizeof(buf), "%ldh %02ldm", hh, mm);
  else             snprintf(buf, sizeof(buf), "%ldm", mm);
  return String(buf);
}

// The number decisions actually get made on: how long until the window rolls.
static String countdown(time_t reset, time_t now) {
  return spanText((long)(reset - now));
}

// Wall-clock reset, with the weekday once it is more than a day out.
static String resetClock(time_t reset, time_t now) {
  if (reset <= 0) return "";
  struct tm t;
  localtime_r(&reset, &t);
  char buf[16];
  strftime(buf, sizeof(buf), reset < now + 86400 ? "%H:%M" : "%a %H:%M", &t);
  return String(buf);
}

// One window, on one card. Two of them fill the page, and the ramp runs down
// rather than across: teal for the five hours, violet for the seven days.
//
// The card says which window; the gradient across the bar and the colour of the
// figure say how full it is. Those are two different questions and this is the
// page where keeping them apart matters most — the 7d window is not a worse
// thing than the 5h one, and colouring the two by severity alone left no way to
// tell at a glance which row you were reading.
static void gauge(const char *label, int16_t y, uint16_t hue, int pct,
                  time_t reset, time_t now, bool timeValid) {
  const int16_t CH = 52;
  const int16_t cy = y + 16;

  panelCard(CARD_X, y, CARD_W, CH, hue);

  if (pct < 0) {
    const BarTrack t = barRow(CARD_X, CARD_W, cy, label, hue, "", C_DIM);
    useFont(UiFont16);
    fb.setTextDatum(ML_DATUM);
    fb.setTextColor(C_DIM);
    fb.drawString("waiting for a reading", t.x + 8, cy);
    return;
  }

  const BarTrack t = barRow(CARD_X, CARD_W, cy, label, hue, String(pct) + "%",
                            severityColor(pct));

  // Filled portion drawn column by column so the ramp is a gradient rather
  // than a handful of discrete blocks.
  int16_t filled = (int16_t)((long)t.w * pct / 100);
  if (filled > t.w) filled = t.w;
  if (filled < 2 && pct > 0) filled = 2;
  for (int16_t x = 0; x < filled; x++) {
    fb.drawFastVLine(t.x + x, cy - BAR_H / 2, BAR_H, rampColor((float)x / t.w));
  }

  // Detail line: when the window rolls over, and how long that is away.
  if (!timeValid || reset <= 0) return;

  useFont(UiFont16);
  fb.setTextDatum(ML_DATUM);
  fb.setTextColor(C_DIM);

  // Flush with the chip above it rather than with the bar, which is what it
  // describes. The card is what makes that the better of the two: one inner
  // margin down the left is a grid, where a second one indented under the bar is
  // a line that starts in a different place on every page depending on how wide
  // the label happened to be — and the Mac's copy of this row needs every pixel
  // of the difference to keep an uptime on a 28-core machine.
  String when = "resets " + resetClock(reset, now);
  int16_t tx = CARD_X + CARD_PAD, ty = y + 38;
  fb.drawString(when, tx, ty);

  // The separator is drawn rather than typed: make_vlw.py only bakes printable
  // ASCII plus the degree sign, so a middle dot would render as a blank box.
  String left = countdown(reset, now);
  if (left.length()) {
    int16_t x = tx + fb.textWidth(when) + 9;
    fb.fillCircle(x, ty, 1, C_DIM);
    fb.drawString("in " + left, x + 9, ty);
  }
}

static void pageUsage(time_t now, bool timeValid) {
  useFont(UiFont16);
  fb.setTextDatum(ML_DATUM);
  fb.setTextColor(C_MAGENTA, C_BG);
  fb.drawString("Claude Code usage", 8, BODY_TOP + 10);

  if (!usage.valid) {
    useFont(UiFont16);
    fb.setTextDatum(MC_DATUM);
    fb.setTextColor(C_ERR, C_BG);
    fb.drawString(usage.error.length() ? usage.error : String("loading..."),
                  SCR_W / 2, 90);
    return;
  }

  // How old the reading is matters as much as the reading: the files behind it
  // only move when something else writes them, so a quiet hour leaves it
  // stale. One the host went and asked for says so instead of counting the
  // seconds since — it is this page being open that makes it live, and it
  // stops being that the moment you leave.
  int age = usageAgeNow();
  if (age >= 0) {
    String label = usage.live ? String("live")
                              : (age < 90 ? String(age) + "s ago"
                                          : String(age / 60) + "m ago");
    fb.setTextDatum(MR_DATUM);
    fb.setTextColor(age > 900 ? C_WARM : C_DIM, C_BG);
    fb.drawString(label, SCR_W - 8, BODY_TOP + 10);
  }

  gauge("5H", 42, C_TEAL,   usage.h5, usage.h5reset, now, timeValid);
  gauge("7D", 98, C_VIOLET, usage.d7, usage.d7reset, now, timeValid);
}

// --- the vitals overlay -------------------------------------------------------
//
// What the system page used to be, drawn over whatever page is showing rather
// than in place of one. Off the cycle it can afford to be complete: the clock
// speed and the boot reason both fit now, where the page had room for one and
// had to trade them against each other.

static void drawVitals() {
  const int16_t x = 8, y = BODY_TOP + 6;
  const int16_t w = SCR_W - 16, h = BODY_BOT - y - 6;

  // A card like the pages', in the ramp's blue. It is the one thing here that is
  // not a page and does not want a hue of its own to be told apart by — what it
  // wants is to look like it belongs to the same panel as whatever it is
  // covering, which is what the card shape does and a flat grey box did not.
  panelCard(x, y, w, h, C_BLUE);

  net::Via link = net::via();
  bool wifi = link == net::Via::Wifi;

  useFont(UiFont16);
  chip(x + 10, y + 13, "Panel", C_VIOLET);

  // What is carrying the data, not what the radio happens to be doing: the USB
  // bridge wins even when WiFi is also associated. It heads the overlay rather
  // than sitting in the grid because it is the field the other network ones are
  // only worth reading in light of.
  String where = link == net::Via::Usb ? String("USB host")
                 : wifi                ? WiFi.SSID()
                                       : String("no link");
  fb.setTextDatum(MR_DATUM);
  fb.setTextColor(link == net::Via::None ? C_ERR : C_OK);
  fb.drawString(where, x + w - 16, y + 13);

  const int16_t LX = 24, RX = 168, CW = 128;
  int16_t ry = y + 26;

  // RSSI only means something on the radio; over USB the field would otherwise
  // show a stale number from whenever WiFi last associated.
  row(LX, CW, ry, "Signal", wifi ? String(WiFi.RSSI()) + " dBm" : String("--"),
      C_TEXT);
  row(RX, CW, ry, "Heap", String(ESP.getFreeHeap() / 1024) + " KB", C_TEXT);
  ry += 21;

  row(LX, CW, ry, "IP", wifi ? WiFi.localIP().toString() : String("--"), C_TEXT);
  // MB, not KB — "Free PSRAM" next to "8083 KB" collided in the column.
  row(RX, CW, ry, "PSRAM", String(ESP.getFreePsram() / 1048576.0f, 1) + " MB",
      C_TEXT);
  ry += 21;

  uint32_t s = millis() / 1000;
  char up[16];
  snprintf(up, sizeof(up), "%luh %02lum", (unsigned long)(s / 3600),
           (unsigned long)((s / 60) % 60));
  row(LX, CW, ry, "Uptime", up, C_TEXT);
  row(RX, CW, ry, "Battery", String(batteryVolts(), 2) + " V", C_TEXT);
  ry += 21;

  // Warm only when the restart was not asked for. "power" after you plugged it
  // in is the answer working, not a warning.
  row(LX, CW, ry, "Boot", bootLabel, bootUnasked ? C_WARM : C_TEXT);
  row(RX, CW, ry, "CPU", String(getCpuFrequencyMhz()) + " MHz", C_TEXT);

  fb.drawFastVLine(x + w / 2, y + 24, h - 34, shade(C_BLUE, 50));
}

// --- page 3: the Mac at the other end of the cable ---------------------------
//
// The vitals and the per-core bars were two pages, and the seam between them was
// never real: both come out of mac_stats_server on the same host, and the "Load
// 2.12/11" row this page used to carry was a one-number summary of the columns
// sitting on the page after it. Merged, the summary goes and the columns stay —
// a row of bars says "the P cores are pinned and the E cores are idle", which is
// the shape of the machine's minute, and a load average never says which.
//
// The columns come down from 94px to 36. Height was the one dimension they were
// not using: they are read against each other rather than against a scale, and
// what carries that is the width the layout in layout.h already fits to the core
// count. What the page buys with the 58px is not having to press a button to see
// both halves of the same machine.
//
// The vertical positions below are measured against the loaded fonts rather than
// eyeballed: ui16 is 26px tall and ui24 39px, and TFT_eSPI hangs a middle-datum
// string half its font height either side of the y it is given. Every gap here
// is the clearance left over once that box is accounted for.

// Charge reads the opposite way to the usage windows: a full bar is the good
// end, so severityColor() would paint a healthy battery red.
static uint16_t chargeColor(int pct) {
  if (pct <= 20) return C_ERR;
  if (pct <= 50) return C_WARM;
  return C_OK;
}

static void pageMac() {
  // The charge card, and the row of cells under it. The bar inside the card is
  // the shared one, so it comes out at the usage page's height and fitted by the
  // same rule — the two pages line up because they are the same code, not
  // because two sets of numbers were kept in step by hand.
  const int16_t BY = 40, BCH = 48;          // the charge card
  const int16_t BAR_Y    = BY + 15;         // the bar's middle
  const int16_t DETAIL_Y = BY + 35;         // the line of small print under it
  const int16_t GRID_Y   = 90, GRID_H = 26; // the three cells
  const int16_t CTOP = 120, CBOT = 150;     // the core columns

  const int16_t HEAD_Y = BODY_TOP + 10;

  useFont(UiFont16);
  fb.setTextDatum(ML_DATUM);
  fb.setTextColor(C_BLUE, C_BG);
  fb.drawString("MacBook", 8, HEAD_Y);
  int16_t headLeft = 8 + fb.textWidth("MacBook");

  // A failed poll leaves the last reading on screen rather than blanking the
  // page, so the age has to be visible or a charge figure from hours ago reads
  // as current. Shown only once it is old enough to mislead — labelling a
  // fresh number "0s ago" every second is noise.
  int age = macAgeNow();
  if (mac.valid && age > 90) {
    String stale = String(age / 60) + "m ago";
    fb.setTextColor(C_WARM, C_BG);
    fb.drawString(stale, headLeft + 10, HEAD_Y);
    headLeft += 10 + fb.textWidth(stale);
  }

  // The rest of the heading is what the Mac is doing, laid out right to left:
  // the power state, and then which screen it is driving.
  int16_t headRight = SCR_W - 8;

  // Power state sits opposite the heading — the one word that changes what the
  // battery number means.
  if (mac.valid && mac.batState.length()) {
    bool onPower = mac.batState != "discharging";
    fb.setTextDatum(MR_DATUM);
    fb.setTextColor(onPower ? C_OK : C_DIM, C_BG);
    fb.drawString(mac.batState, headRight, HEAD_Y);
    headRight -= fb.textWidth(mac.batState) + 12;
  }

  // Which screen, in the panel's own words rather than the server's.
  //
  // "asleep" is the reason for the translation. The server means the screens
  // are off while the machine is up — a Mac that were itself asleep could not
  // answer at all, so this field can only ever be about the display. Printed
  // as one word beside "MacBook" it would say the opposite of what it means,
  // and the reader has no way to know better. "screen off" cannot be misread.
  //
  // Dim in every state on purpose. The four colours on this panel already mean
  // "how bad is this" everywhere else, and none of these is a problem: a laptop
  // driving its own screen is not worse than one driving a monitor.
  //
  // The word is dropped the moment it stops being current, which is the whole
  // difference between this field and the numbers around it. A charge figure a
  // minute old is still roughly true and degrades into a reading you can
  // discount; "external" a minute after the Mac went to sleep is not stale, it
  // is false, and it is false in the one direction that matters — it says the
  // machine is up and driving a monitor. The panel has known better since the
  // twelfth second, because the ping it sends the bridge every four seconds is
  // its own liveness probe and does not need the Mac's cooperation to fail.
  // This is only the draw catching up with what net_link already decided.
  if (mac.valid && mac.display.length()) {
    // Whether the reading is current, which is all this word needs: it is the
    // screen state, and the backlight is the screen state too, so the two
    // cannot end up describing the same machine differently. A dim panel
    // reading "external" would be the panel arguing with itself, and cannot
    // happen — a lit screen is what brightens it. Dim beside "screen off" is
    // the two of them agreeing.
    //
    // Far tighter than the ninety the staleness badge uses, and deliberately:
    // that badge marks numbers worth reading with caution, this marks a word
    // that has to be either right or gone. Past ninety the badge appears, the
    // room here runs out, and the guard below drops this — by then the badge is
    // saying the same thing with a figure attached.
    bool current = macAnswering();
    uint16_t col = current ? C_DIM : C_WARM;

    // "not answering" rather than "asleep": the panel cannot tell a sleeping
    // Mac from an unplugged cable or a bridge that was stopped, and saying
    // which would be inventing the half it does not know. What it does know is
    // that it asked and nothing came back.
    const char *word =
        !current                     ? "not answering"
        : mac.display == "external"  ? "external"
        : mac.display == "builtin"   ? "built-in"
        : mac.display == "asleep"    ? "screen off"
        : mac.display == "none"      ? "no screen"
                                     : nullptr;

    // Gives way to the staleness badge, which is the one that says whether any
    // of this is worth reading at all.
    if (word && headRight - fb.textWidth(word) > headLeft + 10) {
      fb.setTextDatum(MR_DATUM);
      fb.setTextColor(col, C_BG);
      fb.drawString(word, headRight, HEAD_Y);
    }
  }

  // The charge card, drawn before anything that sits on it — which by now is
  // most of the top half of the page, the cores' key included.
  panelCard(CARD_X, BY, CARD_W, BCH, C_BLUE);

  // The cores' key, on the right of the detail line: the cluster mix, each half
  // in its own colour, which is what stops the bars below being an unlabelled
  // row of colours. It is up here rather than over them because there is no room
  // over them.
  //
  // The average used to sit beside it and does not any more — it is a grid cell
  // now. Together the two ran the line into the uptime on its left whenever the
  // average reached two digits, which is most of a working day: measured against
  // the real font, "2h 05m left · up 12d 3h" against "6E+5P 14%" overlaps by
  // 12px and by 39 on a 28-core machine. A line that drops a field depending on
  // how busy the Mac is reads as a glitch, and the fix of shortening the guard
  // would only move the number at which it happens.
  //
  // Drawn before the line's own text, which is left-aligned and grows rightwards
  // into whatever this leaves behind. Same order, and for the same reason, as
  // the temperature and the seconds on the clock page.
  const bool split = cpu.valid && cpu.ecores > 0 && cpu.pcores > 0;
  int16_t keyLeft = CARD_X + CARD_W - CARD_PAD;

  if (split) {
    String e = String(cpu.ecores) + "E", p = String(cpu.pcores) + "P";

    int16_t x = CARD_X + CARD_W - CARD_PAD -
                (fb.textWidth(e) + fb.textWidth("+") + fb.textWidth(p));
    keyLeft = x;
    fb.setTextDatum(ML_DATUM);

    fb.setTextColor(C_ECORE);
    fb.drawString(e, x, DETAIL_Y);
    x += fb.textWidth(e);

    fb.setTextColor(C_DIM);
    fb.drawString("+", x, DETAIL_Y);
    x += fb.textWidth("+");

    fb.setTextColor(C_PCORE);
    fb.drawString(p, x, DETAIL_Y);
  }

  // The three cells that say how much of the machine is spoken for, each on its
  // own card and the ramp running left to right across them. They were three
  // stretches of one row divided by hairlines, which is as much as a hairline
  // can do; three cards say the same thing without a rule, and say as well that
  // memory, disk and CPU are three separate readings rather than one reading in
  // three parts. The figures stay on the severity ramp, which is where the
  // question "is 91% a problem" is answered.
  //
  // Three rather than the two the page had, which is what the labels shortened
  // for: "Memory" and "Disk used" need 95 and 106px of the 96 a third of the
  // width allows. Nothing is lost to that — a disk figure given as a percentage
  // is the used share by convention, and the colour says which end is the bad
  // one on all three.
  //
  // The cards are cut to leave those labels the room the bare row had. "Mem"
  // and a memory figure at 100% come to 87px against the 8px row() insists on
  // keeping between them, so a card 100 wide holding its text 6px inside clears
  // it by one — and a machine that ever does overrun gets "10.." rather than a
  // value written over its own label. Six between the cards and four to the
  // screen either side is what is left of 320 once the three of them are that
  // wide.
  const int16_t GW = 100, G1 = CARD_X, G2 = 110, G3 = 216;
  const int16_t GT = GRID_Y + 1;    // row() takes the top of the line box

  panelCard(G1, GRID_Y, GW, GRID_H, C_TEAL);
  panelCard(G2, GRID_Y, GW, GRID_H, C_VIOLET);
  panelCard(G3, GRID_Y, GW, GRID_H, C_MAGENTA);

  const int16_t GI = GW - 2 * CARD_PAD;

  row(G1 + CARD_PAD, GI, GT, "Mem",
      mac.memUsed >= 0 ? String(mac.memUsed) + "%" : String("--"),
      mac.memUsed >= 0 ? severityColor(mac.memUsed) : C_DIM, C_TEAL);
  row(G2 + CARD_PAD, GI, GT, "Disk",
      mac.diskUsed >= 0 ? String(mac.diskUsed) + "%" : String("--"),
      mac.diskUsed >= 0 ? severityColor(mac.diskUsed) : C_DIM, C_VIOLET);
  // The one cell fed by the other request, and the summary of the columns below
  // it — which is why it can be a number rather than needing to be.
  bool haveAvg = cpu.valid && cpu.avg >= 0;
  row(G3 + CARD_PAD, GI, GT, "CPU",
      haveAvg ? String(cpu.avg) + "%" : String("--"),
      haveAvg ? severityColor(cpu.avg) : C_DIM, C_MAGENTA);

  if (!mac.valid) {
    // Only the top half is missing: the cores come from a different request and
    // may well have answered, so the error takes the space the battery would
    // have had and the columns below still draw.
    useFont(UiFont16);
    fb.setTextDatum(MC_DATUM);
    fb.setTextColor(C_ERR);
    fb.drawString(mac.error.length() ? mac.error : String("loading..."),
                  SCR_W / 2, BAR_Y);
  } else {
    const BarTrack t =
        barRow(CARD_X, CARD_W, BAR_Y, "BAT", C_BLUE,
               mac.batPct >= 0 ? String(mac.batPct) + "%" : String(""),
               chargeColor(mac.batPct));

    if (mac.batPct >= 0 && t.w > 0) {
      int16_t filled = (int16_t)((long)t.w * mac.batPct / 100);
      if (filled > t.w) filled = t.w;
      if (filled < 2 && mac.batPct > 0) filled = 2;
      // Filled flat rather than with the usage page's ramp: there the gradient
      // tracks a cost rising toward its limit, here it would just be decoration.
      fb.fillRect(t.x, BAR_Y - BAR_H / 2, filled, BAR_H,
                  chargeColor(mac.batPct));
    }

    // Detail line under the bar, same shape as the usage gauge's: the separator
    // is a drawn dot because make_vlw.py bakes no middle dot to type.
    useFont(UiFont16);
    fb.setTextDatum(ML_DATUM);
    fb.setTextColor(C_DIM);

    String left = spanText((long)mac.batMins * 60);
    String head = left.length() ? left + " left" : String("no estimate");
    const int16_t tx = CARD_X + CARD_PAD;
    fb.drawString(head, tx, DETAIL_Y);

    // The uptime gives way to the cores' key when the two would meet, the way
    // the seconds give way to the temperature: the key is the one that stops
    // the bars below being an unlabelled row of colours.
    String upFor = spanText((long)mac.up);
    if (upFor.length()) {
      int16_t x = tx + fb.textWidth(head) + 9;
      if (x + 9 + fb.textWidth("up " + upFor) < keyLeft - 8) {
        fb.fillCircle(x, DETAIL_Y, 1, C_DIM);
        fb.drawString("up " + upFor, x + 9, DETAIL_Y);
      }
    }
  }

  // --- the cores --------------------------------------------------------------

  if (!cpu.valid) {
    useFont(UiFont16);
    fb.setTextDatum(MC_DATUM);
    fb.setTextColor(C_ERR, C_BG);
    fb.drawString(cpu.error.length() ? cpu.error : String("loading..."),
                  SCR_W / 2, (CTOP + CBOT) / 2);
    return;
  }

  // One column per core, plus one wider gap where the clusters meet. The
  // sizing is in layout.h, shared with the test that checks every core count
  // from one to MAX_CORES still lands on the panel.
  //
  // `split` above is what decides whether the clusters are coloured apart at
  // all: without the Mac saying where the line falls, every core would come out
  // looking like a P core, which is worse than one flat colour.
  const int16_t MARGIN = 4;
  const int16_t SPLIT  = split ? 10 : 0;
  const int16_t H = CBOT - CTOP;

  const CpuBars bars = cpuBarLayout(cpu.n, SCR_W, MARGIN, SPLIT);
  const int16_t bw = bars.bw, gap = bars.gap;

  // The unlit part of each column carries the cluster colour too, at a level
  // that stays behind the fill — the same relationship a card's body has to the
  // chip on it, and taken from the same function so that it stays that way.
  // Without it an idle Mac is a row of identical grey columns and the whole
  // distinction disappears exactly when the gap between the groups is the only
  // thing left to read.
  const uint16_t TRACK_E = shade(C_ECORE, 34), TRACK_P = shade(C_PCORE, 34);

  int16_t span = cpu.n * bw + (cpu.n - 1) * gap + SPLIT;
  int16_t x0 = (SCR_W - span) / 2;
  if (x0 < MARGIN) x0 = MARGIN;

  for (int i = 0; i < cpu.n; i++) {
    bool perf = split && i >= cpu.ecores;

    int16_t x = x0 + i * (bw + gap) + (perf ? SPLIT : 0);
    // Nothing should reach this now that the width is fitted; it stays as the
    // guard against a core count the arithmetic above cannot squeeze in.
    if (x + bw > SCR_W - MARGIN) break;

    int pct = cpu.core[i];
    if (pct < 0) pct = 0;
    if (pct > 100) pct = 100;

    uint16_t hue   = !split ? C_BLUE               : (perf ? C_PCORE : C_ECORE);
    uint16_t track = !split ? shade(C_BLUE, 34)    : (perf ? TRACK_P : TRACK_E);

    fb.fillRect(x, CTOP, bw, H, track);

    int16_t filled = (int16_t)((long)H * pct / 100);
    if (filled < 2 && pct > 0) filled = 2;
    // Grown from the bottom, so a row of columns reads as level rather than as
    // a set of separate bars that happen to share a baseline.
    if (filled > 0) {
      fb.fillRect(x, CBOT - filled, bw, filled, hue);
    }
  }
}

// --- page 4: the pomodoro timer ----------------------------------------------
//
// Two cards answering two different questions. The top one is the phase you are
// in and how much of it is left, in the 64px face nothing on the panel has had
// a use for since the plain clock page was merged away — a countdown is exactly
// the reading that face was cut for, and it is the one thing on this page worth
// carrying across a room.
//
// The bottom one is the set: four cells, one per block of work, filling as the
// afternoon goes. That is what a pomodoro timer knows and a clock does not, and
// it is a shape rather than a number for the same reason the core columns are —
// three done and one running reads off it without being counted.
//
// The hues are deliberately not the same. The top card goes from magenta to
// teal when the work stops and the rest starts, and to violet for the long one;
// the set stays blue underneath all three, because a set does not change colour
// halfway through.
//
// The vertical numbers are measured against the loaded fonts, as on the Mac
// page: ui16 is 27px tall and big64 107, of which the digits are 46.

// Rounded up, so a phase says 25:00 for the whole of its first second and 0:00
// only when it is actually over. A timer that opens at 24:59 looks broken.
static String pomoClock(uint32_t ms) {
  const uint32_t s = (ms + 999) / 1000;
  char buf[12];
  snprintf(buf, sizeof(buf), "%lu:%02lu", (unsigned long)(s / 60),
           (unsigned long)(s % 60));
  return String(buf);
}

// The same correction FLIP_INK makes, measured the same way and off big64.vlw:
// a 107px line box whose digits sit between y=27 and y=73, so their centre is
// 3px above the box's, and a middle-datum string has to be asked for that far
// below where the digits should land.
static const int16_t POMO_INK = 3;

static void pagePomo(const struct tm *now) {
  const uint16_t hue  = phaseHue(pomo.phase);
  const uint32_t left = pomoLeft();

  useFont(UiFont16);
  fb.setTextDatum(ML_DATUM);
  fb.setTextColor(C_VIOLET, C_BG);
  fb.drawString("Pomodoro", 8, BODY_TOP + 10);

  // The phase, in a chip at the other end of the heading rather than on the
  // card below it: the card is 168px of countdown wide, and a lozenge beside
  // that is a lozenge crowding it.
  const char *tag = phaseChip(pomo.phase);
  chip(SCR_W - 8 - (fb.textWidth(tag) + 12), BODY_TOP + 10, tag, hue);

  // --- the phase --------------------------------------------------------------

  const int16_t CY = 40, CH = 68;
  panelCard(CARD_X, CY, CARD_W, CH, hue);

  // Which of the three states the clock is in, in the corner of the card the
  // digits leave free. The word is the only unambiguous answer — a countdown
  // that has stopped looks exactly like one nobody has started yet — and the
  // colour carries it from further away than the word can be read from.
  const char *state = pomo.running ? "running" : pomoFresh() ? "ready" : "paused";
  fb.setTextDatum(MR_DATUM);
  fb.setTextColor(pomo.running ? C_OK : pomoFresh() ? C_DIM : C_WARM);
  fb.drawString(state, CARD_X + CARD_W - CARD_PAD, CY + 14);

  // Full white while it runs, dim before it has been started, and blinking
  // between the two while it is paused. That last is the flip clock's colon
  // again and for its reason: a figure that has stopped moving on a panel which
  // redraws every second needs to say which of the two happened. The last
  // minute goes warm, on the severity ramp — that one is a reading of how the
  // phase is doing, which is the other question colour here answers.
  uint16_t ink;
  if (pomo.running)      ink = left < 60000UL ? C_WARM : C_TEXT;
  else if (pomoFresh())  ink = C_DIM;
  else                   ink = (now->tm_sec & 1) ? C_DIM : C_TEXT;

  useFont(BigFont64);
  fb.setTextDatum(MC_DATUM);
  fb.setTextColor(ink);
  fb.drawString(pomoClock(left), SCR_W / 2, CY + CH / 2 + POMO_INK);

  // --- the set ----------------------------------------------------------------

  const int16_t SY = 114, SH = 32;
  panelCard(CARD_X, SY, CARD_W, SH, C_BLUE);

  // The same chip, track and figure the usage gauges and the Mac's charge are
  // made of, so the row lands where those rows land — and goes on landing there
  // if any of them is ever moved.
  const BarTrack t = barRow(CARD_X, CARD_W, SY + SH / 2, "SET", C_BLUE,
                            String(pomo.done) + " of " + String(POMO_SET),
                            C_TEXT);

  // Four cells rather than one fill, because what is being counted is four
  // things and not a percentage. Each finished block takes one; the block
  // running now fills its own as it goes, which is the only place on the page
  // the minutes appear as a shape rather than as a figure. The cells sit a
  // shade above the well barRow cut for them — the same level the core columns
  // stand their tracks at, and for the same reason: an empty set has to read as
  // four of something rather than as one long trough.
  if (t.w >= POMO_SET * 4) {
    const int16_t gap = 4;
    const int16_t cw  = (int16_t)((t.w - (POMO_SET - 1) * gap) / POMO_SET);
    const int16_t y   = SY + SH / 2 - BAR_H / 2;

    for (int i = 0; i < POMO_SET; i++) {
      const int16_t x = t.x + i * (cw + gap);
      fb.fillRect(x, y, cw, BAR_H, shade(C_BLUE, 34));

      int16_t fill = 0;
      if (i < pomo.done) {
        fill = cw;
      } else if (i == pomo.done && pomo.phase == Phase::Focus && !pomoFresh()) {
        const uint32_t len = phaseLen(Phase::Focus);
        fill = (int16_t)((uint32_t)cw * (len - left) / len);
      }
      if (fill > 0) fb.fillRect(x, y, fill, BAR_H, C_BLUE);
    }
  }
}

// --- render -----------------------------------------------------------------

// At file scope because the idle hook below redraws too. Both it and loop()
// clear it to force a redraw on the next pass rather than waiting out the
// second.
static uint32_t lastDraw = 0;

// How long the panel may go without redrawing. A second is plenty for everything
// on it: no page shows a figure that arrives faster, and the only one that ever
// showed seconds spends most of them dropping them for the temperature.
//
// A card in mid-fold is the exception, and the only one — it is drawn as an
// animation rather than as a state, so it borrows a frame rate for the third of
// a second it is in flight and gives it straight back. Asked here rather than
// set from inside pageFlip, because both of the places that redraw have to agree
// about it and neither of them is the page.
static uint32_t redrawEvery() {
  if (page == PAGE_FLIP && flipping()) return FLIP_FRAME_MS;

  // A hold in flight is the other thing on the panel that has to be drawn while
  // it happens rather than after. The hint bar names the stop the finger is
  // heading for, and at a second's granularity that line would land late and
  // sometimes not before the finger gave up — so the hold borrows the fold's
  // frame rate for the couple of seconds it is in, the same way and for the
  // same reason.
  if (page == PAGE_POMO && btnAct.pastLong()) return FLIP_FRAME_MS;

  return 1000;
}

static void render() {
  time_t raw = time(nullptr);
  struct tm now;
  localtime_r(&raw, &now);
  bool timeValid = raw > 1700000000;   // anything earlier means NTP hasn't landed

  fb.fillSprite(C_BG);

  switch (page) {
    case PAGE_FLIP:   pageFlip(&now, timeValid); break;
    case PAGE_USAGE:  pageUsage(raw, timeValid); break;
    case PAGE_MAC:    pageMac();                 break;
    case PAGE_POMO:   pagePomo(&now);            break;
  }

  if (vitalsUp) drawVitals();

  drawStatusBar(&now, timeValid);

  // Both of these go over the page rather than instead of it, and the status bar
  // keeps saying which page is underneath, so dismissing lands somewhere
  // expected. A banner outranks the overlay: it arrived on its own, and the
  // overlay was asked for and can be asked for again.
  if (notify.showing) {
    drawBanner();
    drawHintBar("any button  dismiss", "");
  } else if (vitalsUp) {
    // Nothing on the right, as on the banner, because the overlay is modal in
    // the same way: the first press closes it and does nothing else, so every
    // action that could be named here is one the press would not perform. It
    // used to name the backlight hold, which was never true while the overlay
    // was up — the hold closed the overlay and the level stayed where it was —
    // and is now not even true of the page underneath, since the pomodoro page
    // spends that hold on the timer. A hint bar advertising a button that does
    // something else is worse than a hint bar with one thing on it.
    drawHintBar("any button  close", "");
  } else if (page == PAGE_POMO) {
    // The one page where BOOT is not the refresh — there is nothing here to
    // fetch — and so the one page where the hold is not the backlight. Both
    // halves of the button belong to the timer, and the right-hand hint names
    // what the hold will do from where the timer currently stands, because it
    // does two different things. The left drops the vitals to make room; they
    // are on the same hold from any of the other three pages.
    //
    // Mid-hold it stops naming the hold and starts naming the stop below it,
    // which is the only reason a second stop is findable at all: nothing else
    // on the panel could tell you that going on holding buys something more.
    drawHintBar("IO14  next",
                btnAct.pastHeld()   ? "set cleared"
                : btnAct.pastLong() ? "keep holding  clear set"
                : pomo.running      ? "BOOT  pause, hold  reset"
                : pomoFresh()       ? "BOOT  start, hold  skip"
                                    : "BOOT  resume, hold  reset");
  } else {
    // Every other page in the cycle has data worth hurrying, so BOOT is the
    // refresh, and the backlight is on its hold. Both halves of the bar are
    // full at that, which is why the backlight is the one thing on this panel
    // you have to be told about rather than read off it — see the README.
    drawHintBar("IO14  next, hold  vitals", "BOOT  refresh");
  }

  fb.pushSprite(0, 0);
}

// Raw RGB565 dump of the sprite, so the host can see exactly what the panel
// shows. Reassembled by tools/grab_screen.py.
static void dumpScreen() {
  Serial.printf("\nSCREEN %d %d\n", SCR_W, SCR_H);
  Serial.flush();
  Serial.write((const uint8_t *)fb.getPointer(), (size_t)SCR_W * SCR_H * 2);
  Serial.flush();
}

// --- staying alive through a fetch -------------------------------------------
//
// A fetch blocks loop() until the host answers or the timeout runs out, and
// nothing else runs in that window: the clock stops, a press goes unseen, and a
// banner that arrived a moment ago sits undrawn. For the host's own services
// that window is now milliseconds, but the weather still goes out to the
// internet on the host's behalf and is allowed its eight seconds — and eight
// seconds of a stopped clock is precisely how a working panel comes to look
// like a crashed one.
//
// net_link calls this while it waits. It does the two things that must not
// stop, and deliberately not the third: serial commands are left alone, because
// draining them here would take bytes from the reader that is mid-request, and
// a framebuffer dump would land in the middle of the response it is waiting on.

static Press pendingNext = Press::None, pendingAct = Press::None;

static void serviceWhileBlocked() {
  // Latched rather than acted on. poll() reports an event exactly once, so
  // consuming it here and doing nothing with it would turn a press during a
  // fetch into a press that never happened — and the fetch is the very moment
  // someone jabs the button, because the panel looks stuck.
  Press n = btnNext.poll();
  Press a = btnAct.poll();
  if (n != Press::None) pendingNext = n;
  if (a != Press::None) pendingAct  = a;

  // The core feeds the watchdog once per pass through loop(), and loop() has
  // not returned: without this a fetch that takes longer than WDT_TIMEOUT_S
  // would be indistinguishable from a hang and get the panel restarted for
  // doing its job.
  feedLoopWDT();

  updateBacklight();

  if (millis() - lastDraw >= redrawEvery()) {
    lastDraw = millis();
    render();
  }
}

// --- setup / loop -----------------------------------------------------------

void setup() {
  pinMode(PIN_POWER_ON, OUTPUT);
  digitalWrite(PIN_POWER_ON, HIGH);

  btnNext.begin();
  btnAct.begin();
  analogReadResolution(12);

  // HWCDC defaults to a 256-byte RX queue, which is smaller than a single
  // weather response: the host streams the body faster than loop() drains it
  // and the tail is silently dropped, leaving every fetch to time out. Sized
  // above net_link's MAX_BODY so a whole reply always fits, buffered, even if
  // a render lands in the middle of it. Must precede begin(), which only
  // installs the default when no queue exists yet.
  Serial.setRxBufferSize(8192);
  Serial.setTxBufferSize(2048);   // a request URL alone overruns the 256 default
  Serial.begin(115200);
  delay(300);
  Serial.println("\n=== T-Display-S3 dashboard (landscape) ===");

  // Read before anything else can restart the panel, and kept for the system
  // page. The TWDT is already running with the IDF's five-second default and
  // nothing but the idle task subscribed; this widens it and puts the loop task
  // under it. panic = true so a trip leaves a backtrace on the way out —
  // monitor_filters has the decoder — rather than just a silent reboot.
  bootReason = esp_reset_reason();
  bool linkDead = bootReason == ESP_RST_SW && restartTag == TAG_LINK_DEAD;
  restartTag  = 0;
  bootLabel   = linkDead ? "link dead" : resetName(bootReason);
  bootUnasked = linkDead || bootWasAbnormal(bootReason);
  Serial.printf("[boot] last reset: %s\n", bootLabel);

  esp_task_wdt_init(WDT_TIMEOUT_S, true);
  enableLoopWDT();
  Serial.printf("[wdt] watching the loop task, %lus\n",
                (unsigned long)WDT_TIMEOUT_S);

  tft.init();
  tft.setRotation(1);            // landscape, USB on the right
  tft.fillScreen(C_BG);
  pinMode(TFT_BL, OUTPUT);
  analogWrite(TFT_BL, backlight);

  fb.setColorDepth(16);
  if (!fb.createSprite(SCR_W, SCR_H)) {
    Serial.println("FATAL: could not allocate the frame buffer");
    tft.setTextColor(C_ERR, C_BG);
    tft.drawString("sprite alloc failed", 8, 60, 2);
    while (true) delay(1000);
  }

  // A font that fails to parse renders as nothing at all rather than failing
  // loudly, so confirm the metrics match what make_vlw.py wrote.
  for (auto &f : {std::pair<const char *, const uint8_t *>{"ui16", UiFont16},
                  std::pair<const char *, const uint8_t *>{"ui24", UiFont24},
                  std::pair<const char *, const uint8_t *>{"big64", BigFont64},
                  std::pair<const char *, const uint8_t *>{"flip88", FlipFont88}}) {
    useFont(f.second);
    Serial.printf("[font] %-6s height=%2d width(\"20:45\")=%d\n",
                  f.first, fb.fontHeight(), fb.textWidth("20:45"));
  }
  useFont(nullptr);

  // Unconditionally, so the timezone applies to whatever the RTC already holds
  // — it survives a reset, and would otherwise be displayed as UTC. With no
  // network the SNTP client simply never syncs; over USB the bridge supplies
  // the epoch instead and this only decides how it is rendered.
  configTzTime(LOCAL_TZ, "pool.ntp.org", "time.google.com");

  // A restart nobody asked for used to wait on the system page for someone to
  // come and find it. Now that the page is a hold, waiting there would mean
  // never being read at all, so it comes and finds you instead — which is what
  // the banner is for, and the overlay keeps the reason afterwards for as long
  // as the panel stays up.
  if (bootUnasked) {
    raiseLocal("warn", String("Panel restarted: ") + bootLabel, 0);
  }

  net::setIdleHook(serviceWhileBlocked);
  net::begin();
}

void loop() {
  static uint32_t lastWeather = 0, lastUsage = 0, lastMac = 0,
                  lastCpu = 0, lastNotify = 0;
  static bool wasOnline = false;

  // Both are read every pass whatever happens to the result: poll() debounces
  // against the level it saw last time, and a button that goes unpolled while a
  // banner is up would report the release as a press once it resumes.
  //
  // Either may also have been caught by the idle hook during a fetch. That
  // press is picked up here rather than lost with the pass it landed in; the
  // latched one wins, being the older of the two.
  Press nextEv = btnNext.poll();
  Press actEv  = btnAct.poll();
  if (pendingNext != Press::None) { nextEv = pendingNext; pendingNext = Press::None; }
  if (pendingAct  != Press::None) { actEv  = pendingAct;  pendingAct  = Press::None; }

  bool anyPress = nextEv != Press::None || actEv != Press::None;

  // A banner is modal, and so is the overlay. The first press acknowledges
  // whichever is up and does nothing else, so clearing one never also flips the
  // page or the backlight.
  if (anyPress && notify.showing) {
    notify.showing = false;
    nextEv = actEv = Press::None;
    lastDraw = 0;
  } else if (anyPress && vitalsUp) {
    vitalsUp = false;
    nextEv = actEv = Press::None;
    lastDraw = 0;
  }

  // Either button means a person is here, whatever it went on to do.
  if (anyPress) handOverToUser();

  if (nextEv == Press::Short) {
    page = (page + 1) % PAGE_COUNT;
    lastDraw = 0;
    Serial.printf("[ui] page %u\n", page);
  } else if (nextEv == Press::Long) {
    vitalsUp = true;
    lastDraw = 0;
  }

  if (actEv == Press::Short) {
    // Every page fed by a fetch has something worth hurrying. The Mac page
    // clears both of its timers: the vitals are on a ten-second poll, and the
    // cores being on a one-second one is no reason to make the press mean half
    // a page. The pomodoro is fed by nothing, so there the press is the timer.
    if (page == PAGE_FLIP) lastWeather = 0;
    else if (page == PAGE_USAGE) lastUsage = 0;
    else if (page == PAGE_MAC)   lastMac = lastCpu = 0;
    else if (page == PAGE_POMO)  pomoStartPause();
    lastDraw = 0;
  } else if (actEv == Press::Long) {
    if (page == PAGE_POMO) {
      pomoHold();
    } else {
      // Against the level actually showing, so a panel dimmed for the night
      // still comes up on the first press.
      blManual = backlight > BL_ASLEEP ? BL_ASLEEP : BL_AWAKE;
    }
    lastDraw = 0;
  } else if (actEv == Press::Held) {
    // Only the timer has anything this far down. Everywhere else the first stop
    // has already flipped the backlight and there is nothing deeper to reach
    // for, so a finger left resting on the button goes on resting there.
    if (page == PAGE_POMO) {
      pomoClearSet();
      lastDraw = 0;
    }
  }

  // net::loop() also drives the serial reader, so it has to run before the
  // command queue is drained — the two share the same stream of bytes.
  net::loop();

  for (int c = net::readCommand(); c >= 0; c = net::readCommand()) {
    switch (c) {
      // A page command from the host is a person driving too — grab_screen.py
      // walking the pages should not be raced by an automatic switch.
      case 'N': handOverToUser(); page = (page + 1) % PAGE_COUNT; render(); break;
      case 'S': dumpScreen(); break;
      // The overlay's other way in. A hold is a finger on the desk, which is no
      // use to grab_screen.py — and this is the one thing on the panel a host
      // cannot otherwise reach to photograph.
      case 'V': handOverToUser(); vitalsUp = !vitalsUp; render(); break;
      // The timer's own way in, and the only one a host has: the page it lives
      // on is driven by a finger, which is no use to a script walking the pages
      // to photograph one mid-count.
      case 'P': pomoStartPause(); lastDraw = 0; break;
      // The set's only way in from off the board. `P` can start and pause, but
      // nothing out here could put the count back to the beginning, which is
      // the state a script setting up a screenshot wants to start from.
      case 'R': pomoClearSet(); lastDraw = 0; break;
      case 'A':
        autoPages = !autoPages;
        autoReturn = -1;
        Serial.printf("[auto] page selection %s\n", autoPages ? "on" : "off");
        lastDraw = 0;
        break;
      default: break;
    }
  }

  bool online = net::online();
  if (online && !wasOnline) {
    Serial.printf("[net] link up over %s\n", net::viaName());
    lastWeather = 0;
    lastUsage = 0;
    lastMac = 0;
  }
  wasOnline = online;

  // See USB_DEAD_MS. The two guards past the signature itself are about what a
  // restart would cost rather than whether it would work: the radio is already
  // carrying the panel, so there is nothing to recover, and a running timer is
  // state that only exists here — losing twenty-five minutes of it to fix a
  // link nobody is asking anything of is the wrong trade. The timer runs out;
  // the link will still be dead when it does.
  if (net::usbSilentFor() > USB_DEAD_MS && Serial.isPlugged() &&
      !Serial.isConnected() && WiFi.status() != WL_CONNECTED && !pomoEngaged()) {
    Serial.println("[net] bridge silent five minutes with the bus alive - restarting");
    Serial.flush();
    restartTag = TAG_LINK_DEAD;
    esp_restart();
  }

  // NTP only reaches a server when WiFi is up. Over USB the host supplies the
  // epoch instead: once on arrival, then hourly, which is far more often than
  // the drift needs but costs one short round trip.
  static uint32_t lastTimeSync = 0, lastTimeTry = 0;
  bool timeValid = time(nullptr) > 1700000000;
  bool timeDue = !timeValid || lastTimeSync == 0 ||
                 millis() - lastTimeSync > 3600000UL;
  // Rate-limited separately from the success interval: a request that goes
  // unanswered blocks for its timeout, and retrying that every pass through
  // loop() would stall the clock rather than set it.
  if (net::via() == net::Via::Usb && timeDue &&
      (lastTimeTry == 0 || millis() - lastTimeTry > 10000UL)) {
    lastTimeTry = millis();
    if (net::syncTimeFromHost()) lastTimeSync = millis();
  }

  // Refresh on demand, then every 10 minutes. Retry sooner if it failed.
  uint32_t weatherAge = millis() - lastWeather;
  if (online && (lastWeather == 0 || weatherAge > (weather.valid ? 600000UL : 60000UL))) {
    lastWeather = millis();
    fetchWeather();
    lastDraw = 0;
  }

  // The cache moves every time Claude Code renders its status line, so poll
  // often — it is one small request to a machine on the same subnet. It is
  // also what decides whether the panel raises this page on its own, so it is
  // polled from every page and not only from this one.
  //
  // What is only asked for from this page is the live reading: off it the host
  // answers out of its files, which is the request this always was. Arriving
  // asks again immediately rather than waiting out the interval, since the
  // point of the live one is not being from before you looked.
  bool showingUsage = page == PAGE_USAGE && !vitalsUp;
  static bool wasShowingUsage = false;
  if (showingUsage && !wasShowingUsage) lastUsage = 0;
  wasShowingUsage = showingUsage;

  uint32_t usageAge = millis() - lastUsage;
  if (online && (lastUsage == 0 || usageAge > (usage.valid ? 30000UL : 15000UL))) {
    lastUsage = millis();
    fetchUsage(showingUsage);
    lastDraw = 0;
  }

  // Polled harder than a battery percentage needs, because the load average
  // rides along with it and that is what moves the panel to the Mac page. Ten
  // seconds is about how far the page can lag the machine before arriving on it
  // tells you about a minute ago. The host samples in the background, so asking
  // costs a millisecond.
  if (online && (lastMac == 0 || millis() - lastMac > 10000UL)) {
    lastMac = millis();
    fetchMac();
    lastDraw = 0;
  }

  // The cores are the one thing here that want a fresh reading every second,
  // and the only one polled solely while on screen: a blocking request per
  // second is worth it to watch cores move, and pure waste to keep up behind a
  // page nobody is looking at. Leaving lastCpu untouched off-page means coming
  // back to it fetches immediately.
  //
  // It rides on the same page as the Mac's vitals now, which are polled every
  // ten seconds from the same host — two requests a second between them at the
  // worst, both answered out of memory.
  if (online && page == PAGE_MAC && millis() - lastCpu > 1000UL) {
    lastCpu = millis();
    fetchCpu();
    lastDraw = 0;
  }

  // Polled far harder than anything else, because this is the only reading
  // whose whole point is being noticed at once: a hook that stops to ask a
  // question is waiting on the answer. The request costs a couple of hundred
  // bytes and the host answers it out of a dict.
  if (online && millis() - lastNotify > 2000UL) {
    lastNotify = millis();
    if (fetchNotify()) lastDraw = 0;
  }

  // Messages with a ttl take themselves down. An alert posted without one waits
  // for a person, which is the point of being an alert — but not forever:
  // nobody may be coming, and a banner nobody dismisses is a panel stuck on one
  // screen that has also stopped choosing its own pages. Observed doing exactly
  // that for six minutes after the question it asked had already been answered.
  // panel-notify.sh gives its alerts a minute for the same reason.
  uint32_t life = notify.ttl ? notify.ttl : NOTIFY_ALERT_MAX;
  if (notify.showing && millis() - notify.raised > life * 1000UL) {
    notify.showing = false;
    // It ran out with nobody answering it, so the panel goes back to resting
    // rather than staying on whatever page the banner happened to be covering.
    // That page was chosen for a reason that expired with the banner — the
    // question it interrupted is over, and nobody is standing here to have
    // wanted this one. A banner taken down by a press is the opposite case and
    // is left alone below: someone is at the panel, and where they are is
    // theirs.
    restWanted = true;
    lastDraw = 0;
  }

  // Ticked from loop() rather than from the page, because the timer runs
  // whether or not anyone is looking at it. A phase turning over asks for the
  // panel back the same way a banner running out of time does — as a request
  // that waits its turn, since the banner this just raised is in front of it.
  if (pomoTick()) {
    restWanted = true;
    lastDraw = 0;
  }

  updateBacklight();

  // Last, so it decides on this pass's readings rather than the previous one's.
  if (autoPickPage()) lastDraw = 0;

  if (millis() - lastDraw >= redrawEvery()) {
    lastDraw = millis();
    render();
  }

  delay(5);
}
